/dts-v1/;

/ {
	model = "mt6771";
	compatible = "mediatek,mt6771";
	interrupt-parent = <0x1>;
	#address-cells = <0x2>;
	#size-cells = <0x2>;

	chosen {
		bootargs = "console=tty0 console=ttyS0,921600n1 vmalloc=496M slub_max_order=0 slub_debug=OFZPU androidboot.hardware=mt6771 firmware_class.path=/vendor/firmware loop.max_part=7";
		linux,phandle = <0x52>;
		phandle = <0x52>;
	};

	cpus {
		#address-cells = <0x1>;
		#size-cells = <0x0>;

		cpu@000 {
			device_type = "cpu";
			compatible = "arm,cortex-a53";
			reg = <0x0>;
			enable-method = "psci";
			clock-frequency = <0x8b799100>;
			cpu-idle-states = <0x2 0x3 0x4 0x5 0x6 0x7 0x8>;
			linux,phandle = <0x9>;
			phandle = <0x9>;
		};

		cpu@001 {
			device_type = "cpu";
			compatible = "arm,cortex-a53";
			reg = <0x1>;
			enable-method = "psci";
			clock-frequency = <0x8b799100>;
			cpu-idle-states = <0x2 0x3 0x4 0x5 0x6 0x7 0x8>;
			linux,phandle = <0xa>;
			phandle = <0xa>;
		};

		cpu@002 {
			device_type = "cpu";
			compatible = "arm,cortex-a53";
			reg = <0x2>;
			enable-method = "psci";
			clock-frequency = <0x8b799100>;
			cpu-idle-states = <0x2 0x3 0x4 0x5 0x6 0x7 0x8>;
			linux,phandle = <0xb>;
			phandle = <0xb>;
		};

		cpu@003 {
			device_type = "cpu";
			compatible = "arm,cortex-a53";
			reg = <0x3>;
			enable-method = "psci";
			clock-frequency = <0x8b799100>;
			cpu-idle-states = <0x2 0x3 0x4 0x5 0x6 0x7 0x8>;
			linux,phandle = <0xc>;
			phandle = <0xc>;
		};

		cpu@100 {
			device_type = "cpu";
			compatible = "arm,cortex-a73";
			reg = <0x100>;
			enable-method = "psci";
			clock-frequency = <0x8b799100>;
			cpu-idle-states = <0x2 0x3 0x4 0x5 0x6 0x7 0x8>;
			linux,phandle = <0xd>;
			phandle = <0xd>;
		};

		cpu@101 {
			device_type = "cpu";
			compatible = "arm,cortex-a73";
			reg = <0x101>;
			enable-method = "psci";
			clock-frequency = <0x8b799100>;
			cpu-idle-states = <0x2 0x3 0x4 0x5 0x6 0x7 0x8>;
			linux,phandle = <0xe>;
			phandle = <0xe>;
		};

		cpu@102 {
			device_type = "cpu";
			compatible = "arm,cortex-a73";
			reg = <0x102>;
			enable-method = "psci";
			clock-frequency = <0x8b799100>;
			cpu-idle-states = <0x2 0x3 0x4 0x5 0x6 0x7 0x8>;
			linux,phandle = <0xf>;
			phandle = <0xf>;
		};

		cpu@103 {
			device_type = "cpu";
			compatible = "arm,cortex-a73";
			reg = <0x103>;
			enable-method = "psci";
			clock-frequency = <0x8b799100>;
			cpu-idle-states = <0x2 0x3 0x4 0x5 0x6 0x7 0x8>;
			linux,phandle = <0x10>;
			phandle = <0x10>;
		};

		cpu-map {

			cluster0 {

				core0 {
					cpu = <0x9>;
				};

				core1 {
					cpu = <0xa>;
				};

				core2 {
					cpu = <0xb>;
				};

				core3 {
					cpu = <0xc>;
				};
			};

			cluster1 {

				core0 {
					cpu = <0xd>;
				};

				core1 {
					cpu = <0xe>;
				};

				core2 {
					cpu = <0xf>;
				};

				core3 {
					cpu = <0x10>;
				};
			};
		};

		idle-states {
			entry-method = "arm,psci";

			standby {
				compatible = "arm,idle-state";
				arm,psci-suspend-param = <0x1>;
				entry-latency-us = <0x258>;
				exit-latency-us = <0x258>;
				min-residency-us = <0x4b0>;
				linux,phandle = <0x2>;
				phandle = <0x2>;
			};

			mcdi-cpu {
				compatible = "arm,idle-state";
				arm,psci-suspend-param = <0x10001>;
				entry-latency-us = <0x258>;
				exit-latency-us = <0x258>;
				min-residency-us = <0x4b0>;
				linux,phandle = <0x3>;
				phandle = <0x3>;
			};

			mcdi-cluster {
				compatible = "arm,idle-state";
				arm,psci-suspend-param = <0x1010001>;
				entry-latency-us = <0x258>;
				exit-latency-us = <0x258>;
				min-residency-us = <0x4b0>;
				linux,phandle = <0x4>;
				phandle = <0x4>;
			};

			sodi {
				compatible = "arm,idle-state";
				arm,psci-suspend-param = <0x1010002>;
				entry-latency-us = <0x320>;
				exit-latency-us = <0x3e8>;
				min-residency-us = <0x7d0>;
				linux,phandle = <0x5>;
				phandle = <0x5>;
			};

			sodi3 {
				compatible = "arm,idle-state";
				arm,psci-suspend-param = <0x1010003>;
				entry-latency-us = <0x320>;
				exit-latency-us = <0x3e8>;
				min-residency-us = <0x7d0>;
				linux,phandle = <0x6>;
				phandle = <0x6>;
			};

			dpidle {
				compatible = "arm,idle-state";
				arm,psci-suspend-param = <0x1010004>;
				entry-latency-us = <0x320>;
				exit-latency-us = <0x3e8>;
				min-residency-us = <0x7d0>;
				linux,phandle = <0x7>;
				phandle = <0x7>;
			};

			suspend {
				compatible = "arm,idle-state";
				arm,psci-suspend-param = <0x1010005>;
				entry-latency-us = <0x320>;
				exit-latency-us = <0x3e8>;
				min-residency-us = <0x7d0>;
				linux,phandle = <0x8>;
				phandle = <0x8>;
			};
		};
	};

	psci {
		compatible = "arm,psci-1.0";
		method = "smc";
	};

	pmu {
		compatible = "arm,armv8-pmuv3";
		interrupt-parent = <0x11>;
		interrupts = <0x1 0x7 0x8>;
	};

	memory {
		device_type = "memory";
		reg = <0x0 0x40000000 0x0 0x1e605000>;
	};

	cpu_dbgapb@0d410000 {
		compatible = "mediatek,hw_dbg";
		num = <0x8>;
		reg = <0x0 0xd410000 0x0 0x1000 0x0 0xd510000 0x0 0x1000 0x0 0xd610000 0x0 0x1000 0x0 0xd710000 0x0 0x1000 0x0 0xd810000 0x0 0x1000 0x0 0xd910000 0x0 0x1000 0x0 0xda10000 0x0 0x1000 0x0 0xdb10000 0x0 0x1000>;
		linux,phandle = <0x53>;
		phandle = <0x53>;
	};

	atf_logger {
		compatible = "mediatek,atf_logger";
		interrupts = <0x0 0xf5 0x1>;
	};

	amms_control {
		compatible = "mediatek,amms";
		interrupts = <0x0 0x132 0x1>;
	};

	utos {
		compatible = "microtrust,utos";
		interrupts = <0x0 0x128 0x1 0x0 0x129 0x1>;
	};

	utos_tester {
		compatible = "microtrust,tester-v1";
	};

	msdc@11230000 {
		compatible = "mediatek,msdc";
		reg = <0x0 0x11230000 0x0 0x10000>;
		interrupts = <0x0 0x4d 0x8>;
		index = [00];
		clk_src = [01];
		bus-width = <0x8>;
		max-frequency = <0xbebc200>;
		cap-mmc-highspeed;
		msdc-sys-suspend;
		mmc-ddr-1_8v;
		mmc-hs200-1_8v;
		mmc-hs400-1_8v;
		non-removable;
		pinctl = <0x12>;
		register_setting = <0x13>;
		host_function = [00];
		bootable;
		status = "okay";
		vmmc-supply = <0x14>;
		clocks = <0x15 0x20 0x15 0x1d>;
		clock-names = "msdc0-clock", "msdc0-hclock";
		hw_dvfs = [00];
		linux,phandle = <0x3c>;
		phandle = <0x3c>;
	};

	msdc@11240000 {
		compatible = "mediatek,msdc";
		reg = <0x0 0x11240000 0x0 0x10000>;
		interrupts = <0x0 0x4e 0x8>;
		index = [01];
		clk_src = [04];
		bus-width = <0x4>;
		max-frequency = <0x2faf080>;
		msdc-sys-suspend;
		cap-sd-highspeed;
		sd-vmch-fastoff;
		sd-uhs-sdr12;
		sd-uhs-sdr25;
		sd-uhs-sdr50;
		sd-uhs-sdr104;
		sd-uhs-ddr50;
		pinctl = <0x16>;
		pinctl_sdr104 = <0x17>;
		pinctl_sdr50 = <0x18>;
		pinctl_ddr50 = <0x19>;
		register_setting = <0x1a>;
		host_function = [01];
		cd_level = [01];
		cd-gpios = <0x1b 0x3 0x0>;
		status = "okay";
		vmmc-supply = <0x1c>;
		vqmmc-supply = <0x1d>;
		clocks = <0x15 0x29 0x15 0x1e>;
		clock-names = "msdc1-clock", "msdc1-hclock";
		hw_dvfs = [00];
		pinctrl-names = "default";
		pinctrl-0 = <0x1e 0x1f 0x20>;
		linux,phandle = <0x54>;
		phandle = <0x54>;
	};

	msdc0_top@11f50000 {
		compatible = "mediatek,msdc0_top";
		reg = <0x0 0x11f50000 0x0 0x1000>;
	};

	msdc1_top@11e10000 {
		compatible = "mediatek,msdc1_top";
		reg = <0x0 0x11e10000 0x0 0x1000>;
	};

	reserved-memory {
		#address-cells = <0x2>;
		#size-cells = <0x2>;
		ranges;
		linux,phandle = <0x55>;
		phandle = <0x55>;

		pstore-reserved-memory@54410000 {
			compatible = "mediatek,pstore";
			reg = <0x0 0x54410000 0x0 0xe0000>;
		};

		ram_console-reserved-memory@54400000 {
			compatible = "mediatek,ram_console";
			reg = <0x0 0x54400000 0x0 0x10000>;
		};

		minirdump-reserved-memory@544f0000 {
			compatible = "mediatek,minirdump";
			reg = <0x0 0x544f0000 0x0 0x10000>;
		};

		reserve-memory-sspm_share {
			compatible = "mediatek,reserve-memory-sspm_share";
			no-map;
			status = "okay";
			size = <0x0 0x510000>;
			alignment = <0x0 0x10000>;
			alloc-ranges = <0x0 0x40000000 0x0 0x60000000>;
		};

		reserve-memory-scp_share {
			compatible = "mediatek,reserve-memory-scp_share";
			no-map;
			size = <0x0 0x1400000>;
			alignment = <0x0 0x1000000>;
			alloc-ranges = <0x0 0x40000000 0x0 0x50000000>;
		};

		consys-reserve-memory {
			compatible = "mediatek,consys-reserve-memory";
			no-map;
			size = <0x0 0x200000>;
			alignment = <0x0 0x200000>;
			alloc-ranges = <0x0 0x40000000 0x0 0x80000000>;
		};
	};

	interrupt-controller@0c000000 {
		compatible = "arm,gic-v3";
		#interrupt-cells = <0x3>;
		#address-cells = <0x2>;
		#size-cells = <0x2>;
		#redistributor-regions = <0x1>;
		interrupt-parent = <0x11>;
		interrupt-controller;
		reg = <0x0 0xc000000 0x0 0x40000 0x0 0xc100000 0x0 0x200000 0x0 0xc530a80 0x0 0x50>;
		interrupts = <0x1 0x9 0x4>;
		linux,phandle = <0x11>;
		phandle = <0x11>;
	};

	intpol-controller@0c530620 {
		compatible = "mediatek,mt6771-sysirq", "mediatek,mt6577-sysirq";
		interrupt-controller;
		#interrupt-cells = <0x3>;
		interrupt-parent = <0x11>;
		reg = <0x0 0xc530a80 0x0 0x50>;
		linux,phandle = <0x1>;
		phandle = <0x1>;
	};

	mobicore {
		compatible = "trustonic,mobicore";
		interrupts = <0x0 0x130 0x1>;
	};

	chipid@08000000 {
		compatible = "mediatek,chipid";
		reg = <0x0 0x8000000 0x0 0x4 0x0 0x8000004 0x0 0x4 0x0 0x8000008 0x0 0x4 0x0 0x800000c 0x0 0x4>;
	};

	timer {
		compatible = "arm,armv8-timer";
		interrupt-parent = <0x11>;
		interrupts = <0x1 0xd 0x8 0x1 0xe 0x8 0x1 0xb 0x8 0x1 0xa 0x8>;
		clock-frequency = <0xc65d40>;
		linux,phandle = <0x56>;
		phandle = <0x56>;
	};

	clocks {

		clk_null {
			compatible = "fixed-clock";
			#clock-cells = <0x0>;
			clock-frequency = <0x0>;
			linux,phandle = <0x57>;
			phandle = <0x57>;
		};

		clk26m {
			compatible = "fixed-clock";
			#clock-cells = <0x0>;
			clock-frequency = <0x18cba80>;
			linux,phandle = <0x40>;
			phandle = <0x40>;
		};

		clk32k {
			compatible = "fixed-clock";
			#clock-cells = <0x0>;
			clock-frequency = <0x7d00>;
			linux,phandle = <0x2d>;
			phandle = <0x2d>;
		};
	};

	topckgen@10000000 {
		compatible = "mediatek,topckgen", "syscon";
		reg = <0x0 0x10000000 0x0 0x1000>;
		#clock-cells = <0x1>;
		linux,phandle = <0x42>;
		phandle = <0x42>;
	};

	infracfg_ao@10001000 {
		compatible = "mediatek,infracfg_ao", "syscon";
		reg = <0x0 0x10001000 0x0 0x1000>;
		interrupts = <0x0 0x96 0x1>;
		#clock-cells = <0x1>;
		linux,phandle = <0x15>;
		phandle = <0x15>;
	};

	scpsys@10001000 {
		compatible = "mediatek,scpsys";
		reg = <0x0 0x10001000 0x0 0x1000 0x0 0x10006000 0x0 0x1000 0x0 0x1020e000 0x0 0x1000 0x0 0x10000000 0x0 0x1000 0x0 0x1a001000 0x0 0x1000 0x0 0x14019000 0x0 0x1000>;
		#clock-cells = <0x1>;
		linux,phandle = <0x2e>;
		phandle = <0x2e>;
	};

	iocfg_0@10002000 {
		compatible = "mediatek,iocfg_0";
		reg = <0x0 0x10002000 0x0 0x1000>;
	};

	iocfg_1@10002200 {
		compatible = "mediatek,iocfg_1";
		reg = <0x0 0x10002200 0x0 0x1000>;
	};

	iocfg_2@10002400 {
		compatible = "mediatek,iocfg_2";
		reg = <0x0 0x10002400 0x0 0x1000>;
	};

	iocfg_3@10002600 {
		compatible = "mediatek,iocfg_3";
		reg = <0x0 0x10002600 0x0 0x1000>;
	};

	iocfg_4@10002800 {
		compatible = "mediatek,iocfg_4";
		reg = <0x0 0x10002800 0x0 0x1000>;
	};

	iocfg_5@10002a00 {
		compatible = "mediatek,iocfg_5";
		reg = <0x0 0x10002a00 0x0 0x1000>;
	};

	iocfg_6@10002c00 {
		compatible = "mediatek,iocfg_6";
		reg = <0x0 0x10002c00 0x0 0x1000>;
	};

	pericfg@10003000 {
		compatible = "mediatek,pericfg";
		reg = <0x0 0x10003000 0x0 0x1000>;
	};

	gpio {
		compatible = "mediatek,gpio_usage_mapping";
		linux,phandle = <0x58>;
		phandle = <0x58>;
	};

	gpio@10005000 {
		compatible = "mediatek,gpio";
		reg = <0x0 0x10005000 0x0 0x1000>;
		linux,phandle = <0x59>;
		phandle = <0x59>;
	};

	syscfg_pctl_a@10005000 {
		compatible = "mediatek,pctl-a-syscfg", "syscon";
		reg = <0x0 0x10005000 0x0 0x1000>;
		linux,phandle = <0x21>;
		phandle = <0x21>;
	};

	syscfg_pctl_0@11f20000 {
		compatible = "mediatek,pctl-0-syscfg", "syscon";
		reg = <0x0 0x11f20000 0x0 0x1000>;
		linux,phandle = <0x22>;
		phandle = <0x22>;
	};

	syscfg_pctl_1@11e80000 {
		compatible = "mediatek,pctl-1-syscfg", "syscon";
		reg = <0x0 0x11e80000 0x0 0x1000>;
		linux,phandle = <0x23>;
		phandle = <0x23>;
	};

	syscfg_pctl_2@11e70000 {
		compatible = "mediatek,pctl-2-syscfg", "syscon";
		reg = <0x0 0x11e70000 0x0 0x1000>;
		linux,phandle = <0x24>;
		phandle = <0x24>;
	};

	syscfg_pctl_3@11e90000 {
		compatible = "mediatek,pctl-3-syscfg", "syscon";
		reg = <0x0 0x11e90000 0x0 0x1000>;
		linux,phandle = <0x25>;
		phandle = <0x25>;
	};

	syscfg_pctl_4@11d30000 {
		compatible = "mediatek,pctl-4-syscfg", "syscon";
		reg = <0x0 0x11d30000 0x0 0x1000>;
		linux,phandle = <0x26>;
		phandle = <0x26>;
	};

	syscfg_pctl_5@11d20000 {
		compatible = "mediatek,pctl-5-syscfg", "syscon";
		reg = <0x0 0x11d20000 0x0 0x1000>;
		linux,phandle = <0x27>;
		phandle = <0x27>;
	};

	syscfg_pctl_6@11c50000 {
		compatible = "mediatek,pctl-6-syscfg", "syscon";
		reg = <0x0 0x11c50000 0x0 0x1000>;
		linux,phandle = <0x28>;
		phandle = <0x28>;
	};

	syscfg_pctl_7@11f30000 {
		compatible = "mediatek,pctl-7-syscfg", "syscon";
		reg = <0x0 0x11f30000 0x0 0x1000>;
		linux,phandle = <0x29>;
		phandle = <0x29>;
	};

	pinctrl@1000b000 {
		compatible = "mediatek,pinctrl";
		reg = <0x0 0x1000b000 0x0 0x1000>;
		mediatek,pctl-regmap = <0x21 0x22 0x23 0x24 0x25 0x26 0x27 0x28 0x29>;
		pins-are-numbered;
		gpio-controller;
		#gpio-cells = <0x2>;
		interrupt-controller;
		#interrupt-cells = <0x4>;
		interrupts = <0x0 0xb1 0x4>;
		linux,phandle = <0x1b>;
		phandle = <0x1b>;

		msdc0@default {
			linux,phandle = <0x12>;
			phandle = <0x12>;

			pins_cmd {
				drive-strength = [01];
			};

			pins_dat {
				drive-strength = [01];
			};

			pins_clk {
				drive-strength = [02];
			};

			pins_rst {
				drive-strength = [04];
			};

			pins_ds {
				drive-strength = [01];
			};
		};

		msdc0@register_default {
			cmd_edge = [00];
			rdata_edge = [00];
			wdata_edge = [00];
			linux,phandle = <0x13>;
			phandle = <0x13>;
		};

		msdc1@default {
			linux,phandle = <0x16>;
			phandle = <0x16>;

			pins_cmd {
				drive-strength = [03];
			};

			pins_dat {
				drive-strength = [03];
			};

			pins_clk {
				drive-strength = [03];
			};
		};

		msdc1@sdr104 {
			linux,phandle = <0x17>;
			phandle = <0x17>;

			pins_cmd {
				drive-strength = [03];
			};

			pins_dat {
				drive-strength = [03];
			};

			pins_clk {
				drive-strength = [03];
			};
		};

		msdc1@sdr50 {
			linux,phandle = <0x18>;
			phandle = <0x18>;

			pins_cmd {
				drive-strength = [03];
			};

			pins_dat {
				drive-strength = [03];
			};

			pins_clk {
				drive-strength = [03];
			};
		};

		msdc1@ddr50 {
			linux,phandle = <0x19>;
			phandle = <0x19>;

			pins_cmd {
				drive-strength = [03];
			};

			pins_dat {
				drive-strength = [03];
			};

			pins_clk {
				drive-strength = [03];
			};
		};

		msdc1@register_default {
			cmd_edge = [00];
			rdata_edge = [00];
			wdata_edge = [00];
			linux,phandle = <0x1a>;
			phandle = <0x1a>;
		};

		sdc1_cd {
			linux,phandle = <0x1e>;
			phandle = <0x1e>;

			pins_cmd_dat {
				pins = <0x300>;
				slew-rate = <0x0>;
				bias-disable;
			};
		};

		sim1_cd {
			linux,phandle = <0x1f>;
			phandle = <0x1f>;

			pins_cmd_dat {
				pins = <0x2f01>;
				slew-rate = <0x0>;
				bias-disable;
			};
		};

		sim2_cd {
			linux,phandle = <0x20>;
			phandle = <0x20>;

			pins_cmd_dat {
				pins = <0x2e00>;
				slew-rate = <0x0>;
				bias-disable;
			};
		};
	};

	i2c@11007000 {
		compatible = "mediatek,mt6771-i2c";
		id = <0x0>;
		reg = <0x0 0x11007000 0x0 0x1000 0x0 0x11000080 0x0 0x80>;
		interrupts = <0x0 0x51 0x8>;
		clocks = <0x15 0xb 0x15 0x2b>;
		clock-names = "main", "dma";
		clock-div = <0x5>;
		mediatek,hs_only;
		mediatek,skip_scp_sema;
		linux,phandle = <0x5a>;
		phandle = <0x5a>;
	};

	i2c@11011000 {
		compatible = "mediatek,mt6771-i2c";
		id = <0x1>;
		reg = <0x0 0x11011000 0x0 0x1000 0x0 0x11000480 0x0 0x80>;
		interrupts = <0x0 0x55 0x8>;
		clocks = <0x15 0x3a 0x15 0x2b>;
		clock-names = "main", "dma";
		clock-div = <0x5>;
		mediatek,hs_only;
		mediatek,skip_scp_sema;
		linux,phandle = <0x5b>;
		phandle = <0x5b>;
	};

	i2c@11009000 {
		compatible = "mediatek,mt6771-i2c";
		id = <0x2>;
		reg = <0x0 0x11009000 0x0 0x1000 0x0 0x11000280 0x0 0x80>;
		interrupts = <0x0 0x53 0x8>;
		clocks = <0x15 0xd 0x15 0x2b 0x15 0x4a>;
		clock-names = "main", "dma", "arb";
		clock-div = <0x5>;
		ch_offset_default = <0x100>;
		ccu-ch-offset = <0x200>;
		mediatek,hs_only;
		linux,phandle = <0x5c>;
		phandle = <0x5c>;
	};

	i2c@1100f000 {
		compatible = "mediatek,mt6771-i2c";
		id = <0x3>;
		reg = <0x0 0x1100f000 0x0 0x1000 0x0 0x11000400 0x0 0x80>;
		interrupts = <0x0 0x54 0x8>;
		clocks = <0x15 0xe 0x15 0x2b>;
		clock-names = "main", "dma";
		clock-div = <0x5>;
		mediatek,hs_only;
		linux,phandle = <0x5d>;
		phandle = <0x5d>;
	};

	i2c@11008000 {
		compatible = "mediatek,mt6771-i2c";
		id = <0x4>;
		reg = <0x0 0x11008000 0x0 0x1000 0x0 0x11000100 0x0 0x80>;
		interrupts = <0x0 0x52 0x8>;
		clocks = <0x15 0xc 0x15 0x2b 0x15 0x48>;
		clock-names = "main", "dma", "arb";
		clock-div = <0x5>;
		ch_offset_default = <0x100>;
		ccu-ch-offset = <0x200>;
		mediatek,hs_only;
		linux,phandle = <0x5e>;
		phandle = <0x5e>;
	};

	i2c@11017000 {
		compatible = "mediatek,mt6771-i2c";
		id = <0x5>;
		reg = <0x0 0x11017000 0x0 0x1000 0x0 0x11000580 0x0 0x80>;
		interrupts = <0x0 0x85 0x8>;
		clocks = <0x15 0x47 0x15 0x2b 0x15 0x46>;
		clock-names = "main", "dma", "arb";
		clock-div = <0x5>;
		mediatek,hs_only;
		linux,phandle = <0x5f>;
		phandle = <0x5f>;
	};

	i2c@11005000 {
		compatible = "mediatek,mt6771-i2c";
		id = <0x6>;
		reg = <0x0 0x11005000 0x0 0x1000 0x0 0x11000600 0x0 0x80>;
		interrupts = <0x0 0x57 0x8>;
		clocks = <0x15 0x58 0x15 0x2b>;
		clock-names = "main", "dma";
		clock-div = <0x5>;
		mediatek,hs_only;
		linux,phandle = <0x60>;
		phandle = <0x60>;
	};

	i2c@1101a000 {
		compatible = "mediatek,mt6771-i2c";
		id = <0x7>;
		reg = <0x0 0x1101a000 0x0 0x1000 0x0 0x11000680 0x0 0x80>;
		interrupts = <0x0 0x58 0x8>;
		clocks = <0x15 0x63 0x15 0x2b>;
		clock-names = "main", "dma";
		clock-div = <0x5>;
		mediatek,hs_only;
		linux,phandle = <0x61>;
		phandle = <0x61>;
	};

	i2c@1101b000 {
		compatible = "mediatek,mt6771-i2c";
		id = <0x8>;
		reg = <0x0 0x1101b000 0x0 0x1000 0x0 0x11000700 0x0 0x80>;
		interrupts = <0x0 0x59 0x8>;
		clocks = <0x15 0x64 0x15 0x2b>;
		clock-names = "main", "dma";
		clock-div = <0x5>;
		mediatek,hs_only;
		linux,phandle = <0x62>;
		phandle = <0x62>;
	};

	i2c@11014000 {
		compatible = "mediatek,mt6771-i2c";
		id = <0x9>;
		reg = <0x0 0x11014000 0x0 0x1000 0x0 0x11000180 0x0 0x80>;
		interrupts = <0x0 0x83 0x8>;
		clocks = <0x15 0x49 0x15 0x2b 0x15 0x48>;
		clock-names = "main", "dma", "arb";
		clock-div = <0x5>;
		mediatek,hs_only;
		linux,phandle = <0x63>;
		phandle = <0x63>;
	};

	i2c@11015000 {
		compatible = "mediatek,mt6771-i2c";
		id = <0xa>;
		reg = <0x0 0x11015000 0x0 0x1000 0x0 0x11000300 0x0 0x80>;
		interrupts = <0x0 0x84 0x8>;
		clocks = <0x15 0x4b 0x15 0x2b 0x15 0x4a>;
		clock-names = "main", "dma", "arb";
		clock-div = <0x5>;
		mediatek,hs_only;
		linux,phandle = <0x64>;
		phandle = <0x64>;
	};

	i2c@11016000 {
		compatible = "mediatek,mt6771-i2c";
		id = <0xb>;
		reg = <0x0 0x11016000 0x0 0x1000 0x0 0x11000500 0x0 0x80>;
		interrupts = <0x0 0x56 0x8>;
		clocks = <0x15 0x45 0x15 0x2b 0x15 0x46>;
		clock-names = "main", "dma", "arb";
		clock-div = <0x5>;
		mediatek,hs_only;
		linux,phandle = <0x65>;
		phandle = <0x65>;
	};

	sspm@10440000 {
		compatible = "mediatek,sspm";
		reg = <0x0 0x10440000 0x0 0x10000 0x0 0x10450000 0x0 0x100 0x0 0x10451000 0x0 0x8 0x0 0x10460000 0x0 0x100 0x0 0x10461000 0x0 0x8 0x0 0x10470000 0x0 0x100 0x0 0x10471000 0x0 0x8 0x0 0x10480000 0x0 0x100 0x0 0x10481000 0x0 0x8 0x0 0x10490000 0x0 0x100 0x0 0x10491000 0x0 0x8>;
		reg-names = "cfgreg", "mbox0_base", "mbox0_ctrl", "mbox1_base", "mbox1_ctrl", "mbox2_base", "mbox2_ctrl", "mbox3_base", "mbox3_ctrl", "mbox4_base", "mbox4_ctrl";
		interrupts = <0x0 0xd0 0x4 0x0 0xd3 0x4 0x0 0xd4 0x4 0x0 0xd5 0x4 0x0 0xd6 0x4 0x0 0xd7 0x4>;
		interrupt-names = "ipc", "mbox0", "mbox1", "mbox2", "mbox3", "mbox4";
	};

	sleep@10006000 {
		compatible = "mediatek,sleep";
		reg = <0x0 0x10006000 0x0 0x1000>;
		interrupts = <0x0 0xbb 0x8>;
		wakeup-source = <0x2a 0x0 0x4 0x2b 0x1 0x20 0x2c 0x3 0x2000000>;
	};

	toprgu@10007000 {
		compatible = "mediatek,toprgu";
		reg = <0x0 0x10007000 0x0 0x1000>;
		interrupts = <0x0 0x8e 0x0>;
	};

	apxgpt@10008000 {
		compatible = "mediatek,apxgpt";
		reg = <0x0 0x10008000 0x0 0x100>;
		interrupts = <0x0 0xb0 0x8>;
		clocks = <0x2d>;
	};

	rsvd@10009000 {
		compatible = "mediatek,rsvd";
		reg = <0x0 0x10009000 0x0 0x1000>;
	};

	hacc@1000a000 {
		compatible = "mediatek,hacc";
		reg = <0x0 0x1000a000 0x0 0x1000>;
		interrupts = <0x0 0xc3 0x8>;
	};

	apirq@1000b000 {
		compatible = "mediatek,apirq";
		reg = <0x0 0x1000b000 0x0 0x1000>;
		interrupts = <0x0 0xb1 0x4>;
	};

	apmixed@1000c000 {
		compatible = "mediatek,apmixed", "syscon";
		reg = <0x0 0x1000c000 0x0 0x1000>;
		#clock-cells = <0x1>;
		linux,phandle = <0x66>;
		phandle = <0x66>;
	};

	fhctl@1000ce00 {
		compatible = "mediatek,fhctl";
		reg = <0x0 0x1000ce00 0x0 0x1000>;
	};

	pwrap@1000d000 {
		compatible = "mediatek,pwrap";
		reg = <0x0 0x1000d000 0x0 0x1000>;
		interrupts = <0x0 0xb9 0x4>;

		pmic_irq {
			compatible = "mediatek,pmic-eint";
			interrupt-controller;
			linux,phandle = <0x67>;
			phandle = <0x67>;
		};
	};

	pwrap_mpu@1000d000 {
		compatible = "mediatek,pwrap_mpu";
		reg = <0x0 0x1000d000 0x0 0x1000>;
	};

	pwrap_p2p@1005e000 {
		compatible = "mediatek,pwrap_p2p";
		reg = <0x0 0x105cb000 0x0 0x1000>;
	};

	pwrap_md32@10448000 {
		compatible = "mediatek,pwrap_md32";
		reg = <0x0 0x10448000 0x0 0x1000>;
	};

	sleep_reg_md@1000f000 {
		compatible = "mediatek,sleep_reg_md";
		reg = <0x0 0x1000f000 0x0 0x1000>;
	};

	kp@10010000 {
		compatible = "mediatek,kp";
		reg = <0x0 0x10010000 0x0 0x1000>;
		interrupts = <0x0 0xba 0x2>;
		linux,phandle = <0x2a>;
		phandle = <0x2a>;
	};

	mrdump_ext_rst {
		compatible = "mediatek, no-mrdump_ext_rst-eint";
		source = "EINT";
		mode = "IRQ";
		status = "okay";
		linux,phandle = <0x68>;
		phandle = <0x68>;
	};

	topmisc@10011000 {
		compatible = "mediatek,topmisc";
		reg = <0x0 0x10011000 0x0 0x1000>;
	};

	dvfsrc_top@10012000 {
		compatible = "mediatek,dvfsrc_top";
		reg = <0x0 0x10012000 0x0 0x1000 0x0 0x11bb80 0x0 0x80>;
	};

	apcldmain_ao@10014000 {
		compatible = "mediatek,apcldmain_ao";
		reg = <0x0 0x10014000 0x0 0x1000>;
	};

	apcldmaout_ao@10014400 {
		compatible = "mediatek,apcldmaout_ao";
		reg = <0x0 0x10014400 0x0 0x1000>;
	};

	apcldmamisc_ao@10014800 {
		compatible = "mediatek,apcldmamisc_ao";
		reg = <0x0 0x10014800 0x0 0x1000>;
	};

	devapc_mpu_ao@10015000 {
		compatible = "mediatek,devapc_mpu_ao";
		reg = <0x0 0x10015000 0x0 0x1000>;
	};

	aes_top0@10016000 {
		compatible = "mediatek,aes_top0";
		reg = <0x0 0x10016000 0x0 0x1000>;
	};

	sys_timer@10017000 {
		compatible = "mediatek,sys_timer";
		reg = <0x0 0x10017000 0x0 0x1000>;
		reg-names = "sys_timer_base";
		interrupts = <0x0 0xca 0x4>;
	};

	modem_temp_share@10018000 {
		compatible = "mediatek,modem_temp_share";
		reg = <0x0 0x10018000 0x0 0x1000>;
	};

	mbist_ao@10013000 {
		compatible = "mediatek,mbist_ao";
		reg = <0x0 0x10013000 0x0 0x1000>;
	};

	security_ao@1001a000 {
		compatible = "mediatek,security_ao";
		reg = <0x0 0x1001a000 0x0 0x1000>;
	};

	topckgen_ao@1001b000 {
		compatible = "mediatek,topckgen_ao";
		reg = <0x0 0x1001b000 0x0 0x1000>;
	};

	scp@10500000 {
		compatible = "mediatek,scp";
		status = "okay";
		reg = <0x0 0x10500000 0x0 0x80000 0x0 0x105c0000 0x0 0x3000 0x0 0x105c4000 0x0 0x1000 0x0 0x105d4000 0x0 0x6000>;
		interrupts = <0x0 0xae 0x4>;
		linux,phandle = <0x69>;
		phandle = <0x69>;
	};

	scp_cfgreg@105c0000 {
		compatible = "mediatek,scp_cfgreg";
		reg = <0x0 0x105c0000 0x0 0x1000>;
	};

	scp_mad@105c1000 {
		compatible = "mediatek,scp_mad";
		reg = <0x0 0x105c1000 0x0 0x1000>;
	};

	scp_intc@105c2000 {
		compatible = "mediatek,scp_intc";
		reg = <0x0 0x105c2000 0x0 0x1000>;
	};

	scp_timer@105c3000 {
		compatible = "mediatek,scp_timer";
		reg = <0x0 0x105c3000 0x0 0x1000>;
	};

	scp_clk_ctrl@105c4000 {
		compatible = "mediatek,scp_clk_ctrl";
		reg = <0x0 0x105c4000 0x0 0x1000>;
	};

	scp_i2c0@105c5000 {
		compatible = "mediatek,scp_i2c0";
		reg = <0x0 0x105c5000 0x0 0x1000>;
	};

	scp_i2c1@105c6000 {
		compatible = "mediatek,scp_i2c1";
		reg = <0x0 0x105c6000 0x0 0x1000>;
	};

	scp_i2c2@105c7000 {
		compatible = "mediatek,scp_i2c2";
		reg = <0x0 0x105c7000 0x0 0x1000>;
	};

	scp_gpio@105c8000 {
		compatible = "mediatek,scp_gpio";
		reg = <0x0 0x105c8000 0x0 0x1000>;
	};

	scp_uart@105c9000 {
		compatible = "mediatek,scp_uart";
		reg = <0x0 0x105c9000 0x0 0x1000>;
	};

	scp_cirq_eint@105ca000 {
		compatible = "mediatek,scp_cirq_eint";
		reg = <0x0 0x105ca000 0x0 0x1000>;
	};

	scp_dma@105cd000 {
		compatible = "mediatek,scp_dma";
		reg = <0x0 0x105cd000 0x0 0x1000>;
	};

	scp_uart1@105ce000 {
		compatible = "mediatek,scp_uart1";
		reg = <0x0 0x105ce000 0x0 0x1000>;
	};

	scp_spi0@105cf000 {
		compatible = "mediatek,scp_spi0";
		reg = <0x0 0x105cf000 0x0 0x1000>;
	};

	scp_spi1@105d0000 {
		compatible = "mediatek,scp_spi1";
		reg = <0x0 0x105d0000 0x0 0x1000>;
	};

	scp_spi2@105d1000 {
		compatible = "mediatek,scp_spi2";
		reg = <0x0 0x105d1000 0x0 0x1000>;
	};

	dbgapb@0d000000 {
		compatible = "mediatek,dbgapb";
		reg = <0x0 0xd000000 0x0 0x1000>;
	};

	mcucfg@0c530000 {
		compatible = "mediatek,mcucfg";
		reg = <0x0 0xc530000 0x0 0x1000>;
		interrupts = <0x0 0x0 0x8>;
	};

	mp0_cpucfg@0c530000 {
		compatible = "mediatek,mp0_cpucfg";
		reg = <0x0 0xc530000 0x0 0x1000>;
	};

	mp1_cpucfg@0c530200 {
		compatible = "mediatek,mp1_cpucfg";
		reg = <0x0 0xc530200 0x0 0x1000>;
	};

	mcu_misccfg@0c530400 {
		compatible = "mediatek,mcu_misccfg";
		reg = <0x0 0xc530400 0x0 0x1000>;
	};

	mcu_misc1cfg@0c530800 {
		compatible = "mediatek,mcu_misc1cfg";
		reg = <0x0 0xc530800 0x0 0x1000>;
	};

	mp2_ca15m_config@0c532000 {
		compatible = "mediatek,mp2_ca15m_config";
		reg = <0x0 0xc532000 0x0 0x1000>;
	};

	mcucfg_mp0_counter@0c530000 {
		compatible = "mediatek,mcucfg_mp0_counter";
		reg = <0x0 0xc530000 0x0 0x2000>;
	};

	mcucfg_mp2_counter@0c532000 {
		compatible = "mediatek,mcucfg_mp2_counter";
		reg = <0x0 0xc532000 0x0 0x1000>;
	};

	infracfg@1020e000 {
		compatible = "mediatek,infracfg";
		reg = <0x0 0x1020e000 0x0 0x1000>;
	};

	sramrom@10214000 {
		compatible = "mediatek,sramrom";
		reg = <0x0 0x10214000 0x0 0x1000>;
	};

	emi@10219000 {
		compatible = "mediatek,emi";
		reg = <0x0 0x10219000 0x0 0x1000 0x0 0x10226000 0x0 0x1000 0x0 0x1022d000 0x0 0x1000 0x0 0x10235000 0x0 0x1000>;
		interrupts = <0x0 0x93 0x8 0x0 0x94 0x4 0x0 0x9b 0x4>;
	};

	sys_cirq@10204000 {
		compatible = "mediatek,sys_cirq";
		reg = <0x0 0x10204000 0x0 0x1000>;
		mediatek,cirq_num = <0xe7>;
		mediatek,spi_start_offset = <0x48>;
		interrupts = <0x0 0x12f 0x8>;
	};

	m4u@10205000 {
		cell-index = <0x0>;
		compatible = "mediatek,m4u";
		reg = <0x0 0x10205000 0x0 0x1000>;
		interrupts = <0x0 0xa6 0x8>;
	};

	devapc@10207000 {
		compatible = "mediatek,devapc";
		reg = <0x0 0x10207000 0x0 0x1000>;
		interrupts = <0x0 0x91 0x8>;
		clocks = <0x15 0x2d>;
		clock-names = "devapc-infra-clock";
	};

	bus_dbg@10208000 {
		compatible = "mediatek,bus_dbg-v2";
		reg = <0x0 0x10208000 0x0 0x1000>;
		interrupts = <0x0 0x90 0x8>;
	};

	ap_ccif0@10209000 {
		compatible = "mediatek,ap_ccif0";
		reg = <0x0 0x10209000 0x0 0x1000>;
		interrupts = <0x0 0x97 0x8>;
	};

	md_ccif0@1020a000 {
		compatible = "mediatek,md_ccif0";
		reg = <0x0 0x1020a000 0x0 0x1000>;
	};

	ap_ccif1@1020b000 {
		compatible = "mediatek,ap_ccif1";
		reg = <0x0 0x1020b000 0x0 0x1000>;
		interrupts = <0x0 0x99 0x8>;
	};

	md_ccif1@1020c000 {
		compatible = "mediatek,md_ccif1";
		reg = <0x0 0x1020c000 0x0 0x1000>;
	};

	ap_ccif2@1023c000 {
		compatible = "mediatek,ap_ccif2";
		reg = <0x0 0x1023c000 0x0 0x1000>;
		interrupts = <0x0 0x9c 0x8>;
	};

	md_ccif2@1023d000 {
		compatible = "mediatek,md_ccif2";
		reg = <0x0 0x1023d000 0x0 0x1000>;
	};

	ap_ccif3@1023e000 {
		compatible = "mediatek,ap_ccif3";
		reg = <0x0 0x1023e000 0x0 0x1000>;
		interrupts = <0x0 0x9d 0x8>;
	};

	md_ccif3@1023f000 {
		compatible = "mediatek,md_ccif3";
		reg = <0x0 0x1023f000 0x0 0x1000>;
	};

	infra_mbist@1020d000 {
		compatible = "mediatek,infra_mbist";
		reg = <0x0 0x1020d000 0x0 0x1000>;
	};

	trng@1020f000 {
		compatible = "mediatek,trng";
		reg = <0x0 0x1020f000 0x0 0x1000>;
		interrupts = <0x0 0xa9 0x8>;
	};

	dxcc_sec@10210000 {
		compatible = "mediatek,dxcc_sec";
		reg = <0x0 0x10210000 0x0 0x1000>;
		interrupts = <0x0 0xaa 0x4>;
	};

	smi_common_ao@10211000 {
		compatible = "mediatek,smi_common_ao";
		reg = <0x0 0x10211000 0x0 0x1000>;
	};

	cq_dma@10212000 {
		compatible = "mediatek,mt-cqdma-v1";
		reg = <0x0 0x10212000 0x0 0x80 0x0 0x10212080 0x0 0x80 0x0 0x10212100 0x0 0x80>;
		interrupts = <0x0 0x73 0x8 0x0 0x74 0x8 0x0 0x75 0x8>;
		nr_channel = <0x3>;
		clocks = <0x15 0x4e>;
		clock-names = "cqdma";
	};

	wifi@180f0000 {
		compatible = "mediatek,wifi";
		reg = <0x0 0x180f0000 0x0 0x1100 0x0 0x10212180 0x0 0x6c 0x0 0x10001000 0x0 0x1000 0x0 0x180e0000 0x0 0x70>;
		interrupts = <0x0 0x122 0x8 0x0 0x76 0x8>;
		clocks = <0x15 0x4e>;
		clock-names = "wifi-dma";
		hardware-values = <0x788 0xa5800 0xa5800>;
		linux,phandle = <0x6a>;
		phandle = <0x6a>;
	};

	mipi_tx0@11e50000 {
		compatible = "mediatek,mipi_tx0";
		reg = <0x0 0x11e50000 0x0 0x1000>;
	};

	mipi_tx1@10216000 {
		compatible = "mediatek,mipi_tx1";
		reg = <0x0 0x10216000 0x0 0x1000>;
	};

	mipi_rx_ana_csi0a@11c80000 {
		compatible = "mediatek,mipi_rx_ana_csi0a";
		reg = <0x0 0x11c80000 0x0 0x1000>;
	};

	mipi_rx_ana_csi0b@11c81000 {
		compatible = "mediatek,mipi_rx_ana_csi0b";
		reg = <0x0 0x11c81000 0x0 0x1000>;
	};

	mipi_rx_ana_csi1a@11c82000 {
		compatible = "mediatek,mipi_rx_ana_csi1a";
		reg = <0x0 0x11c82000 0x0 0x1000>;
	};

	mipi_rx_ana_csi1b@11c83000 {
		compatible = "mediatek,mipi_rx_ana_csi1b";
		reg = <0x0 0x11c83000 0x0 0x1000>;
	};

	mipi_rx_ana_csi2a@11c84000 {
		compatible = "mediatek,mipi_rx_ana_csi2a";
		reg = <0x0 0x11c84000 0x0 0x1000>;
	};

	mipi_rx_ana_csi2b@11c85000 {
		compatible = "mediatek,mipi_rx_ana_csi2b";
		reg = <0x0 0x11c85000 0x0 0x1000>;
	};

	gcpu_rsa@1021a000 {
		compatible = "mediatek,gcpu_rsa";
		reg = <0x0 0x1021a000 0x0 0x1000>;
	};

	apcldmain@1021b000 {
		compatible = "mediatek,apcldmain";
		reg = <0x0 0x1021b000 0x0 0x1000>;
	};

	apcldmaout@1021b400 {
		compatible = "mediatek,apcldmaout";
		reg = <0x0 0x1021b400 0x0 0x1000>;
	};

	apcldmamisc@1021b800 {
		compatible = "mediatek,apcldmamisc";
		reg = <0x0 0x1021b800 0x0 0x1000>;
		interrupts = <0x0 0xad 0x4>;
	};

	mdcldmain@1021c000 {
		compatible = "mediatek,mdcldmain";
		reg = <0x0 0x1021c000 0x0 0x1000>;
	};

	mdcldmaout@1021c400 {
		compatible = "mediatek,mdcldmaout";
		reg = <0x0 0x1021c400 0x0 0x1000>;
	};

	mdcldmamisc@1021c800 {
		compatible = "mediatek,mdcldmamisc";
		reg = <0x0 0x1021c800 0x0 0x1000>;
	};

	infra_md@1021d000 {
		compatible = "mediatek,infra_md";
		reg = <0x0 0x1021d000 0x0 0x1000>;
	};

	mdcldma@10014000 {
		compatible = "mediatek,mdcldma";
		reg = <0x0 0x10014000 0x0 0x1000 0x0 0x1021b000 0x0 0x1000 0x0 0x10209000 0x0 0x1000 0x0 0x1020a000 0x0 0x1000>;
		interrupts = <0x0 0xad 0x4 0x0 0x97 0x8 0x0 0x98 0x8 0x0 0x11b 0x2>;
		mediatek,md_id = <0x0>;
		mediatek,cldma_capability = <0x6>;
		clocks = <0x2e 0x1 0x15 0x37 0x15 0x2e 0x15 0x31 0x15 0x26 0x15 0x27 0x15 0x5d 0x15 0x5e>;
		clock-names = "scp-sys-md1-main", "infra-cldma-bclk", "infra-ccif-ap", "infra-ccif-md", "infra-ccif1-ap", "infra-ccif1-md", "infra-ccif2-ap", "infra-ccif2-md";
		linux,phandle = <0x2c>;
		phandle = <0x2c>;
	};

	infra_md_cfg@1021d000 {
		compatible = "mediatek,infra_md_cfg";
		reg = <0x0 0x1021d000 0x0 0x1000>;
	};

	bpi_bsi_slv0@1021e000 {
		compatible = "mediatek,bpi_bsi_slv0";
		reg = <0x0 0x1021e000 0x0 0x1000>;
	};

	bpi_bsi_slv1@1021f000 {
		compatible = "mediatek,bpi_bsi_slv1";
		reg = <0x0 0x1021f000 0x0 0x1000>;
	};

	bpi_bsi_slv2@10225000 {
		compatible = "mediatek,bpi_bsi_slv2";
		reg = <0x0 0x10225000 0x0 0x1000>;
	};

	dvfsp@10227000 {
		compatible = "mediatek,dvfsp";
		reg = <0x0 0x10227000 0x0 0x1000>;
		interrupts = <0x0 0xab 0x8>;
	};

	dvfsp@0011bc00 {
		compatible = "mediatek,mt6771-dvfsp";
		reg = <0x0 0x11bc00 0x0 0x1400 0x0 0x11bc00 0x0 0x1400>;
	};

	mcdi@0011b000 {
		compatible = "mediatek,mt6771-mcdi";
		reg = <0x0 0x11b000 0x0 0x800>;
	};

	dramc@1022a000 {
		compatible = "mediatek,dramc";
		reg = <0x0 0x1022a000 0x0 0x2000 0x0 0x10232000 0x0 0x2000 0x0 0x1022c000 0x0 0x1000 0x0 0x10234000 0x0 0x1000 0x0 0x10228000 0x0 0x2000 0x0 0x10230000 0x0 0x2000 0x0 0x1022e000 0x0 0x1000 0x0 0x10236000 0x0 0x1000>;
	};

	fmem_smi@10238000 {
		compatible = "mediatek,fmem_smi";
		reg = <0x0 0x10238000 0x0 0x1000>;
	};

	gce@10238000 {
		compatible = "mediatek,gce";
		reg = <0x0 0x10238000 0x0 0x1000>;
		interrupts = <0x0 0xa2 0x8 0x0 0xa3 0x8>;
		disp_mutex_reg = <0x14016000 0x1000>;
		g3d_config_base = <0x13000000 0x0 0xffff0000>;
		mmsys_config_base = <0x14000000 0x1 0xffff0000>;
		disp_dither_base = <0x14010000 0x2 0xffff0000>;
		mm_na_base = <0x14020000 0x3 0xffff0000>;
		imgsys_base = <0x15020000 0x4 0xffff0000>;
		vdec_gcon_base = <0x18800000 0x5 0xffff0000>;
		venc_gcon_base = <0x18810000 0x6 0xffff0000>;
		conn_peri_base = <0x18820000 0x7 0xffff0000>;
		topckgen_base = <0x18830000 0x8 0xffff0000>;
		kp_base = <0x18840000 0x9 0xffff0000>;
		scp_sram_base = <0x10000000 0xa 0xffff0000>;
		infra_na3_base = <0x10010000 0xb 0xffff0000>;
		infra_na4_base = <0x10020000 0xc 0xffff0000>;
		scp_base = <0x10030000 0xd 0xffff0000>;
		mcucfg_base = <0x10040000 0xe 0xffff0000>;
		gcpu_base = <0x10050000 0xf 0xffff0000>;
		usb0_base = <0x10200000 0x10 0xffff0000>;
		usb_sif_base = <0x10280000 0x11 0xffff0000>;
		audio_base = <0x17000000 0x12 0xffff0000>;
		vdec_base = <0x17010000 0x13 0xffff0000>;
		msdc2_base = <0x17020000 0x14 0xffff0000>;
		vdec1_base = <0x17030000 0x15 0xffff0000>;
		msdc3_base = <0x18000000 0x16 0xffff0000>;
		ap_dma_base = <0x18010000 0x17 0xffff0000>;
		gce_base = <0x18020000 0x18 0xffff0000>;
		vdec2_base = <0x18040000 0x19 0xffff0000>;
		vdec3_base = <0x18050000 0x1a 0xffff0000>;
		camsys_base = <0x18080000 0x1b 0xffff0000>;
		camsys1_base = <0x180a0000 0x1c 0xffff0000>;
		camsys2_base = <0x180b0000 0x1d 0xffff0000>;
		pwm_sw_base = <0x11000000 0x63 0xffff0000>;
		mipitx0_base = <0x11e50000 0x63 0xffff0000>;
		disp_rdma0_sof = <0x0>;
		disp_rdma1_sof = <0x1>;
		mdp_rdma0_sof = <0x2>;
		mdp_rsz0_sof = <0x4>;
		mdp_rsz1_sof = <0x5>;
		mdp_tdshp_sof = <0x6>;
		mdp_wrot0_sof = <0x7>;
		mdp_wdma_sof = <0x8>;
		disp_ovl0_sof = <0x9>;
		disp_2l_ovl0_sof = <0xa>;
		disp_2l_ovl1_sof = <0xb>;
		disp_wdma0_sof = <0xc>;
		disp_color0_sof = <0xd>;
		disp_ccorr0_sof = <0xe>;
		disp_aal0_sof = <0xf>;
		disp_gamma0_sof = <0x10>;
		disp_dither0_sof = <0x11>;
		disp_pwm0_sof = <0x12>;
		disp_dsi0_sof = <0x13>;
		disp_dpi0_sof = <0x14>;
		disp_rsz0_sof = <0x16>;
		mdp_aal_sof = <0x17>;
		mdp_ccorr_sof = <0x18>;
		disp_dbi0_sof = <0x19>;
		disp_rdma0_frame_done = <0x1a>;
		disp_rdma1_frame_done = <0x1b>;
		mdp_rdma0_frame_done = <0x1c>;
		mdp_rsz0_frame_done = <0x1e>;
		mdp_rsz1_frame_done = <0x1f>;
		mdp_tdshp_frame_done = <0x20>;
		mdp_wrot0_write_frame_done = <0x21>;
		mdp_wdma_frame_done = <0x22>;
		disp_ovl0_frame_done = <0x23>;
		disp_2l_ovl0_frame_done = <0x24>;
		disp_2l_ovl1_frame_done = <0x25>;
		disp_wdma0_frame_done = <0x26>;
		disp_color0_frame_done = <0x27>;
		disp_ccorr0_frame_done = <0x28>;
		disp_aal0_frame_done = <0x29>;
		disp_gamma0_frame_done = <0x2a>;
		disp_dither0_frame_done = <0x2b>;
		disp_dsi0_frame_done = <0x2c>;
		disp_dpi0_frame_done = <0x2d>;
		disp_rsz0_frame_done = <0x2f>;
		mdp_aal_frame_done = <0x30>;
		mdp_ccorr_frame_done = <0x31>;
		disp_dbi0_frame_done = <0x32>;
		stream_done_0 = <0x82>;
		stream_done_1 = <0x83>;
		stream_done_2 = <0x84>;
		stream_done_3 = <0x85>;
		stream_done_4 = <0x86>;
		stream_done_5 = <0x87>;
		stream_done_6 = <0x88>;
		stream_done_7 = <0x89>;
		stream_done_8 = <0x8a>;
		stream_done_9 = <0x8b>;
		stream_done_10 = <0x8c>;
		stream_done_11 = <0x8d>;
		buf_underrun_event_0 = <0x8e>;
		buf_underrun_event_1 = <0x8f>;
		dsi0_te_event = <0x90>;
		dsi0_irq_event = <0x91>;
		dsi0_done_event = <0x92>;
		disp_wdma0_rst_done = <0x96>;
		mdp_wdma_rst_done = <0x97>;
		mdp_wrot0_rst_done = <0x98>;
		mdp_rdma0_rst_done = <0x9a>;
		disp_ovl0_frame_rst_done_pusle = <0x9b>;
		disp_ovl0_2l_frame_rst_done_pusle = <0x9c>;
		disp_ovl1_2l_frame_rst_done_pusle = <0x9d>;
		dip_cq_thread0_frame_done = <0x101>;
		dip_cq_thread1_frame_done = <0x102>;
		dip_cq_thread2_frame_done = <0x103>;
		dip_cq_thread3_frame_done = <0x104>;
		dip_cq_thread4_frame_done = <0x105>;
		dip_cq_thread5_frame_done = <0x106>;
		dip_cq_thread6_frame_done = <0x107>;
		dip_cq_thread7_frame_done = <0x108>;
		dip_cq_thread8_frame_done = <0x109>;
		dip_cq_thread9_frame_done = <0x10a>;
		dip_cq_thread10_frame_done = <0x10b>;
		dip_cq_thread11_frame_done = <0x10c>;
		dip_cq_thread12_frame_done = <0x10d>;
		dip_cq_thread13_frame_done = <0x10e>;
		dip_cq_thread14_frame_done = <0x10f>;
		dip_cq_thread15_frame_done = <0x110>;
		dip_cq_thread16_frame_done = <0x111>;
		dip_cq_thread17_frame_done = <0x112>;
		dip_cq_thread18_frame_done = <0x113>;
		amd_frame_done = <0x114>;
		dve_frame_done = <0x115>;
		wmf_frame_done = <0x116>;
		rsc_frame_done = <0x117>;
		mfb_done = <0x118>;
		wpe_a_frame_done = <0x119>;
		wpe_b_frame_done = <0x11a>;
		occ_done = <0x11b>;
		venc_done = <0x121>;
		jpgenc_done = <0x122>;
		jpgdec_done = <0x123>;
		venc_mb_done = <0x124>;
		venc_128byte_cnt_done = <0x125>;
		isp_frame_done_a = <0x141>;
		isp_frame_done_b = <0x142>;
		camsv_0_pass1_done = <0x143>;
		camsv_1_pass1_done = <0x144>;
		camsv_2_pass1_done = <0x145>;
		tsf_done = <0x146>;
		seninf_0_fifo_full = <0x147>;
		seninf_1_fifo_full = <0x148>;
		seninf_2_fifo_full = <0x149>;
		seninf_3_fifo_full = <0x14a>;
		seninf_4_fifo_full = <0x14b>;
		seninf_5_fifo_full = <0x14c>;
		seninf_6_fifo_full = <0x14d>;
		seninf_7_fifo_full = <0x14e>;
		ipu_done_0 = <0x161>;
		ipu_done_1 = <0x162>;
		ipu_done_2 = <0x163>;
		ipu_done_3 = <0x164>;
		ipu_done_1_0 = <0x181>;
		ipu_done_1_1 = <0x182>;
		ipu_done_1_2 = <0x183>;
		ipu_done_1_3 = <0x184>;
		max_prefetch_cnt = <0x4>;
		prefetch_size = <0xa0 0x20 0x20 0x20>;
		sram_size_cpr_64 = <0x88>;
		mmsys_config = <0x2f>;
		mm_mutex = <0x30>;
		mdp_rdma0 = <0x31>;
		mdp_rdma1 = <0x32>;
		mdp_rsz0 = <0x33>;
		mdp_rsz1 = <0x34>;
		mdp_wrot0 = <0x35>;
		mdp_wdma0 = <0x36>;
		mdp_tdshp0 = <0x37>;
		mdp_aal0 = <0x38>;
		mdp_ccorr0 = <0x39>;
		mdp_color0 = <0x3a>;
		venc = <0x3b>;
		msdc0 = <0x3c>;
		audio = <0x3d>;
		uart = <0x3e>;
		smi_larb0 = <0x3f>;
		sram_share_cnt = <0x1>;
		sram_share_engine = <0x18>;
		sram_share_event = <0x2c6>;
		clocks = <0x15 0x9 0x15 0x19>;
		clock-names = "GCE", "GCE_TIMER";
	};

	gic@1023a000 {
		compatible = "mediatek,gic";
		reg = <0x0 0x1023a000 0x0 0x1000>;
	};

	ap_dma@11000000 {
		compatible = "mediatek,ap_dma";
		reg = <0x0 0x11000000 0x0 0x1000>;
		interrupts = <0x0 0x5e 0x8>;
	};

	auxadc@11001000 {
		compatible = "mediatek,auxadc";
		reg = <0x0 0x11001000 0x0 0x1000>;
		interrupts = <0x0 0x4a 0x2>;
		clocks = <0x15 0x24>;
		clock-names = "auxadc-main";
		linux,phandle = <0x6b>;
		phandle = <0x6b>;
	};

	dma-controller@11000780 {
		compatible = "mediatek,mt6577-uart-dma";
		reg = <0x0 0x11000780 0x0 0x80 0x0 0x11000800 0x0 0x80 0x0 0x11000880 0x0 0x80 0x0 0x11000900 0x0 0x80 0x0 0x11000980 0x0 0x80 0x0 0x11000a00 0x0 0x80>;
		interrupts = <0x0 0x6c 0x8 0x0 0x6d 0x8 0x0 0x6e 0x8 0x0 0x6f 0x8 0x0 0x70 0x8 0x0 0x71 0x8>;
		clocks = <0x15 0x2b>;
		clock-names = "apdma";
		#dma-cells = <0x1>;
		linux,phandle = <0x41>;
		phandle = <0x41>;
	};

	serial@11002000 {
		compatible = "mediatek,mt6577-uart";
		reg = <0x0 0x11002000 0x0 0x1000>;
		interrupts = <0x0 0x5b 0x8>;
		clocks = <0x40 0x15 0x15>;
		clock-names = "baud", "bus";
		dmas = <0x41 0x0 0x41 0x1>;
		dma-names = "tx", "rx";
		linux,phandle = <0x3e>;
		phandle = <0x3e>;
	};

	serial@11003000 {
		compatible = "mediatek,mt6577-uart";
		reg = <0x0 0x11003000 0x0 0x1000>;
		interrupts = <0x0 0x5c 0x8>;
		clocks = <0x40 0x15 0x16>;
		clock-names = "baud", "bus";
		linux,phandle = <0x6c>;
		phandle = <0x6c>;
	};

	serial@11004000 {
		compatible = "mediatek,mt6577-uart";
		reg = <0x0 0x11004000 0x0 0x1000>;
		interrupts = <0x0 0x5d 0x8>;
		clocks = <0x40 0x15 0x17>;
		clock-names = "baud", "bus";
		linux,phandle = <0x6d>;
		phandle = <0x6d>;
	};

	i2c6@11005000 {
		compatible = "mediatek,i2c6";
		reg = <0x0 0x11005000 0x0 0x1000>;
		interrupts = <0x0 0x57 0x8>;
	};

	pwm@11006000 {
		compatible = "mediatek,pwm";
		reg = <0x0 0x11006000 0x0 0x1000>;
		interrupts = <0x0 0x4b 0x8>;
		clocks = <0x15 0x10 0x15 0x11 0x15 0x12 0x15 0x13 0x15 0xf 0x15 0x14>;
		clock-names = "PWM1-main", "PWM2-main", "PWM3-main", "PWM4-main", "PWM-HCLK-main", "PWM-main";
	};

	spi@1100a000 {
		compatible = "mediatek,mt6771-spi";
		mediatek,pad-select = <0x0>;
		reg = <0x0 0x1100a000 0x0 0x1000>;
		interrupts = <0x0 0x78 0x8>;
		clocks = <0x42 0x37 0x42 0x7 0x15 0x1c>;
		clock-names = "parent-clk", "sel-clk", "spi-clk";
		linux,phandle = <0x6e>;
		phandle = <0x6e>;
	};

	spi@11010000 {
		compatible = "mediatek,mt6771-spi";
		mediatek,pad-select = <0x0>;
		reg = <0x0 0x11010000 0x0 0x1000>;
		interrupts = <0x0 0x7c 0x8>;
		clocks = <0x42 0x37 0x42 0x7 0x15 0x39>;
		clock-names = "parent-clk", "sel-clk", "spi-clk";
		linux,phandle = <0x6f>;
		phandle = <0x6f>;
	};

	spi@11012000 {
		compatible = "mediatek,mt6771-spi";
		mediatek,pad-select = <0x0>;
		reg = <0x0 0x11012000 0x0 0x1000>;
		interrupts = <0x0 0x81 0x8>;
		clocks = <0x42 0x37 0x42 0x7 0x15 0x3c>;
		clock-names = "parent-clk", "sel-clk", "spi-clk";
		linux,phandle = <0x70>;
		phandle = <0x70>;
	};

	spi@11013000 {
		compatible = "mediatek,mt6771-spi";
		mediatek,pad-select = <0x0>;
		reg = <0x0 0x11013000 0x0 0x1000>;
		interrupts = <0x0 0x82 0x8>;
		clocks = <0x42 0x37 0x42 0x7 0x15 0x3d>;
		clock-names = "parent-clk", "sel-clk", "spi-clk";
		mediatek,rt;
		linux,phandle = <0x71>;
		phandle = <0x71>;
	};

	spi@11018000 {
		compatible = "mediatek,mt6771-spi";
		mediatek,pad-select = <0x0>;
		reg = <0x0 0x11018000 0x0 0x1000>;
		interrupts = <0x0 0x86 0x8>;
		clocks = <0x42 0x37 0x42 0x7 0x15 0x4c>;
		clock-names = "parent-clk", "sel-clk", "spi-clk";
		linux,phandle = <0x72>;
		phandle = <0x72>;
	};

	spi@11019000 {
		compatible = "mediatek,mt6771-spi";
		mediatek,pad-select = <0x0>;
		reg = <0x0 0x11019000 0x0 0x1000>;
		interrupts = <0x0 0x87 0x8>;
		clocks = <0x42 0x37 0x42 0x7 0x15 0x4d>;
		clock-names = "parent-clk", "sel-clk", "spi-clk";
		linux,phandle = <0x73>;
		phandle = <0x73>;
	};

	therm_ctrl@1100b000 {
		compatible = "mediatek,therm_ctrl";
		reg = <0x0 0x1100b000 0x0 0x1000>;
		interrupts = <0x0 0x4f 0x8>;
		clocks = <0x15 0xa>;
		clock-names = "therm-main";
	};

	eem_fsm@1100b000 {
		compatible = "mediatek,eem_fsm";
		reg = <0x0 0x1100b000 0x0 0x1000>;
		interrupts = <0x0 0x7f 0x8>;
	};

	btif@1100c000 {
		compatible = "mediatek,btif";
		reg = <0x0 0x1100c000 0x0 0x1000 0x0 0x11000a80 0x0 0x80 0x0 0x11000b00 0x0 0x80>;
		interrupts = <0x0 0x72 0x8 0x0 0x8b 0x8 0x0 0x8c 0x8>;
		clocks = <0x15 0x1b 0x15 0x2b>;
		clock-names = "btifc", "apdmac";
	};

	consys@18070000 {
		compatible = "mediatek,mt6771-consys";
		reg = <0x0 0x18070000 0x0 0x1000 0x0 0x10007000 0x0 0x100 0x0 0x10001000 0x0 0x1000 0x0 0x10006000 0x0 0x1000>;
		interrupts = <0x0 0x121 0x8 0x0 0x123 0x8>;
		clocks = <0x2e 0x2>;
		clock-names = "conn";
		linux,phandle = <0x2b>;
		phandle = <0x2b>;
	};

	irtx@1100d000 {
		compatible = "mediatek,irtx";
		reg = <0x0 0x1100d000 0x0 0x1000>;
	};

	irtx_pwm {
		compatible = "mediatek,irtx-pwm";
		pwm_ch = <0x0>;
		pwm_data_invert = <0x0>;
		linux,phandle = <0x74>;
		phandle = <0x74>;
	};

	disp_pwm0@1100e000 {
		compatible = "mediatek,disp_pwm0";
		reg = <0x0 0x1100e000 0x0 0x1000>;
		interrupts = <0x0 0x80 0x8>;
	};

	usb3@11200000 {
		compatible = "mediatek,usb3";
		reg = <0x0 0x11200000 0x0 0x10000 0x0 0x11203e00 0x0 0x100 0x0 0x11f40000 0x0 0x10000>;
		reg-names = "ssusb_base", "ssusb_ippc", "ssusb_sif2";
		interrupts = <0x0 0x48 0x8 0x0 0x49 0x8>;
		interrupt-names = "musb-hdrc", "xhci";
		debug_level = <0x6>;
		fgpa_i2c_physical_base = <0x11009000>;
		linux,phandle = <0x75>;
		phandle = <0x75>;
	};

	otg_iddig {
		compatible = "mediatek,usb_iddig_bi_eint";
		linux,phandle = <0x76>;
		phandle = <0x76>;
	};

	usb3_tune {
		compatible = "mediatek,phy_tuning";
		u2_vrt_ref = <0x6>;
		u2_term_ref = <0x7>;
		u2_enhance = <0x2>;
		u2_vrt_ref_host = <0x3>;
		u2_term_ref_host = <0x3>;
		u2_enhance_host = <0x2>;
		status = "okay";
		linux,phandle = <0x77>;
		phandle = <0x77>;
	};

	usb3_xhci@11200000 {
		compatible = "mediatek,mt67xx-xhci";
		reg = <0x0 0x11200000 0x0 0x10000 0x0 0x11203e00 0x0 0x100>;
		reg-names = "ssusb_base", "ssusb_ippc";
		interrupts = <0x0 0x49 0x8>;
		interrupt-names = "xhci";
		linux,phandle = <0x78>;
		phandle = <0x78>;
	};

	btcvsd@10001000 {
		compatible = "mediatek,audio_bt_cvsd";
		offset = <0xf00 0x800 0xfd0 0xfd4 0xfd8>;
		reg = <0x0 0x10001000 0x0 0x1000 0x0 0x18000000 0x0 0x1000 0x0 0x18080000 0x0 0x10000>;
		interrupts = <0x0 0x120 0x8>;
	};

	audio@11220000 {
		compatible = "mediatek,audio", "syscon";
		reg = <0x0 0x11220000 0x0 0x1000>;
		#clock-cells = <0x1>;
		linux,phandle = <0x3d>;
		phandle = <0x3d>;
	};

	mt_soc_dl1_pcm@11220000 {
		compatible = "mediatek,mt_soc_pcm_dl1";
		reg = <0x0 0x11220000 0x0 0x1000>;
		interrupts = <0x0 0xa1 0x8>;
		clocks = <0x3d 0x9 0x3d 0x3 0x3d 0x2 0x3d 0x4 0x3d 0xe 0x3d 0x8 0x3d 0x7 0x3d 0x5 0x3d 0x6 0x3d 0x1 0x2e 0x8 0x15 0x30 0x15 0x38 0x42 0xc 0x42 0xd 0x42 0x31 0x42 0x14 0x42 0x49 0x42 0x15 0x42 0x4d 0x42 0x1f 0x42 0x4c 0x42 0x20 0x42 0x50 0x40>;
		clock-names = "aud_afe_clk", "aud_dac_clk", "aud_dac_predis_clk", "aud_adc_clk", "aud_adc_adda6_clk", "aud_apll22m_clk", "aud_apll24m_clk", "aud_apll1_tuner_clk", "aud_apll2_tuner_clk", "aud_tml_clk", "scp_sys_audio", "aud_infra_clk", "mtkaif_26m_clk", "top_mux_audio", "top_mux_audio_int", "top_syspll_d2_d4", "top_mux_aud_1", "top_apll1_ck", "top_mux_aud_2", "top_apll2_ck", "top_mux_aud_eng1", "top_apll1_d8", "top_mux_aud_eng2", "top_apll2_d8", "top_clk26m_clk";
		linux,phandle = <0x79>;
		phandle = <0x79>;
	};

	audio_sram@11221000 {
		compatible = "mediatek,audio_sram";
		reg = <0x0 0x11221000 0x0 0xc000>;
	};

	ufshci@11270000 {
		compatible = "mediatek,ufshci";
		reg = <0x0 0x11270000 0x0 0x2300>;
		interrupts = <0x0 0x50 0x8>;
		clocks = <0x15 0x4f 0x15 0x3e 0x15 0x40>;
		clock-names = "ufs0-clock", "ufs0-unipro-clk", "ufs0-mp-clk";
		freq-table-hz = <0x0 0x0 0x0 0x0 0x0 0x0>;
		vcc-supply = <0x14>;
		vcc-fixed-regulator;
		mediatek,auto-hibern8-timer = <0xa>;
		mediatek,spm-level = <0x3>;
		mediatek,rpm-enable = <0x1>;
		mediatek,rpm-autosuspend-delay = <0x7d0>;
		mediatek,rpm-level = <0x3>;
		linux,phandle = <0x7a>;
		phandle = <0x7a>;
	};

	ca9peri@10e00000 {
		compatible = "mediatek,ca9peri";
		reg = <0x0 0x10e00000 0x0 0x1000>;
	};

	l2c@10f00000 {
		compatible = "mediatek,l2c";
		reg = <0x0 0x10f00000 0x0 0x1000>;
	};

	efusec@11f10000 {
		compatible = "mediatek,efusec";
		reg = <0x0 0x11f10000 0x0 0x1000>;
	};

	ufs_mphy@11fa0000 {
		compatible = "mediatek,ufs_mphy";
		reg = <0x0 0x11fa0000 0x0 0xc000>;
	};

	mfgcfg@13000000 {
		compatible = "mediatek,mfgcfg", "syscon";
		reg = <0x0 0x13000000 0x0 0x1000 0x0 0x10001000 0x0 0x1000 0x0 0x10006000 0x0 0x1000 0x0 0x1020e000 0x0 0x1000 0x0 0xd000000 0x0 0xf0000>;
		#clock-cells = <0x1>;
		linux,phandle = <0x43>;
		phandle = <0x43>;
	};

	mali@13040000 {
		compatible = "mediatek,mali", "arm,mali-midgard", "arm,mali-bifrost";
		reg = <0x0 0x13040000 0x0 0x4000>;
		interrupts = <0x0 0x116 0x8 0x0 0x117 0x8 0x0 0x118 0x8>;
		interrupt-names = "GPU", "MMU", "JOB";
	};

	gpufreq {
		compatible = "mediatek,mt6771-gpufreq";
		clocks = <0x42 0x4 0x42 0x61 0x40 0x43 0x1 0x2e 0x7 0x2e 0x4 0x2e 0xb 0x2e 0xa 0x2e 0xc>;
		clock-names = "clk_mux", "clk_main_parent", "clk_sub_parent", "subsys_mfg_cg", "mtcmos_mfg_async", "mtcmos_mfg", "mtcmos_mfg_core0", "mtcmos_mfg_core1", "mtcmos_mfg_core2";
	};

	mali_tb@1307f000 {
		compatible = "mediatek,mali_tb";
		reg = <0x0 0x1307f000 0x0 0x1000>;
	};

	mfg_dfp_60@13020000 {
		compatible = "mediatek,mfg_dfp_60";
		reg = <0x0 0x13020000 0x0 0x1000>;
		interrupts = <0x0 0x11a 0x8>;
	};

	mfg_tb@13ffef00 {
		compatible = "mediatek,mfg_tb";
		reg = <0x0 0x13ffef00 0x0 0x1000>;
	};

	mmsys_config@14000000 {
		compatible = "mediatek,mmsys_config", "syscon";
		reg = <0x0 0x14000000 0x0 0x1000>;
		interrupts = <0x0 0xef 0x8>;
		#clock-cells = <0x1>;
		clocks = <0x2f 0xb 0x2f 0x25 0x2f 0xc 0x2f 0x26>;
		clock-names = "CAM_MDP_TX", "CAM_MDP_RX", "CAM_MDP2_TX", "CAM_MDP2_RX";
		linux,phandle = <0x2f>;
		phandle = <0x2f>;
	};

	touch {
		compatible = "mediatek,mt6771-touch";
		linux,phandle = <0x7b>;
		phandle = <0x7b>;
	};

	accdet {
		compatible = "mediatek,pmic-accdet";
		linux,phandle = <0x7c>;
		phandle = <0x7c>;
	};

	mt6358_gauge {
		compatible = "mediatek,mt6358_gauge";
		gauge_name = "gauge";
		alias_name = "MT6358";
	};

	gauge_timer {
		compatible = "mediatek,gauge_timer_service";
	};

	battery {
		compatible = "mediatek,bat_gm30";
		DIFFERENCE_FULLOCV_ITH = <0xd2>;
		SHUTDOWN_1_TIME = <0x3c>;
		KEEP_100_PERCENT = <0x1>;
		R_FG_VALUE = <0xa>;
		EMBEDDED_SEL = <0x0>;
		PMIC_SHUTDOWN_CURRENT = <0x9>;
		FG_METER_RESISTANCE = <0x32>;
		CAR_TUNE_VALUE = <0x64>;
		PMIC_MIN_VOL = <0x84d0>;
		POWERON_SYSTEM_IBOOT = <0x1f4>;
		SHUTDOWN_GAUGE0_VOLTAGE = <0x84d0>;
		TEMPERATURE_T0 = <0x32>;
		TEMPERATURE_T1 = <0x19>;
		TEMPERATURE_T2 = <0xa>;
		TEMPERATURE_T3 = <0x0>;
		TEMPERATURE_T4 = <0xfffffff6>;
		g_FG_PSEUDO100_T0 = <0x69>;
		g_FG_PSEUDO100_T1 = <0x69>;
		g_FG_PSEUDO100_T2 = <0x69>;
		g_FG_PSEUDO100_T3 = <0x69>;
		g_FG_PSEUDO100_T4 = <0x69>;
		Q_MAX_SYS_VOLTAGE_BAT0 = <0xd48>;
		Q_MAX_SYS_VOLTAGE_BAT1 = <0xd48>;
		Q_MAX_SYS_VOLTAGE_BAT2 = <0xd48>;
		Q_MAX_SYS_VOLTAGE_BAT3 = <0xd48>;
		battery0_profile_t0_num = <0x64>;
		battery0_profile_t0 = <0x0 0xaa50 0x320 0x13b 0xa9d1 0x32f 0x276 0xa958 0x32b 0x3b2 0xa8e7 0x334 0x4ed 0xa86b 0x334 0x628 0xa7f6 0x334 0x763 0xa77e 0x328 0x89e 0xa70c 0x331 0x9da 0xa690 0x334 0xb15 0xa61e 0x334 0xc50 0xa5a6 0x334 0xd8b 0xa530 0x334 0xec7 0xa4be 0x334 0x1002 0xa448 0x32b 0x113d 0xa3d1 0x32e 0x1278 0xa369 0x334 0x13b3 0xa2f0 0x324 0x14ef 0xa287 0x334 0x162a 0xa215 0x325 0x1765 0xa1a4 0x334 0x18a0 0xa135 0x325 0x19db 0xa0cb 0x334 0x1b17 0xa059 0x324 0x1c52 0x9ff2 0x321 0x1d8d 0x9f8d 0x334 0x1ec8 0x9f27 0x334 0x2004 0x9ecb 0x334 0x213f 0x9e67 0x334 0x227a 0x9e06 0x334 0x23b5 0x9da7 0x334 0x24f0 0x9d43 0x334 0x262c 0x9cdf 0x337 0x2767 0x9c87 0x340 0x28a2 0x9c2e 0x334 0x29dd 0x9bdf 0x347 0x2b18 0x9b87 0x334 0x2c54 0x9b2f 0x334 0x2d8f 0x9ade 0x334 0x2eca 0x9a88 0x334 0x3005 0x9a2b 0x343 0x3140 0x99af 0x334 0x327c 0x991c 0x334 0x33b7 0x989b 0x334 0x34f2 0x9842 0x334 0x362d 0x97f5 0x334 0x3769 0x97a5 0x323 0x38a4 0x9764 0x334 0x39df 0x972e 0x334 0x3b1a 0x96ef 0x334 0x3c55 0x96b0 0x334 0x3d91 0x9673 0x312 0x3ecc 0x9645 0x32c 0x4007 0x9614 0x32e 0x4142 0x95db 0x321 0x427d 0x95b2 0x334 0x43b9 0x9584 0x334 0x44f4 0x9557 0x325 0x462f 0x952e 0x334 0x476a 0x9508 0x334 0x48a6 0x94e3 0x33e 0x49e1 0x94b5 0x329 0x4b1c 0x948d 0x334 0x4c57 0x9471 0x334 0x4d92 0x9451 0x334 0x4ece 0x942f 0x334 0x5009 0x940a 0x334 0x5144 0x93ed 0x334 0x527f 0x93c8 0x334 0x53ba 0x9399 0x334 0x54f6 0x9350 0x337 0x5631 0x9304 0x348 0x576c 0x92c5 0x33b 0x58a7 0x9293 0x334 0x59e2 0x926b 0x338 0x5b1e 0x9238 0x33f 0x5c59 0x920d 0x342 0x5d94 0x91dd 0x335 0x5ecf 0x91b7 0x343 0x600b 0x9196 0x33e 0x6146 0x9175 0x357 0x6281 0x913b 0x334 0x63bc 0x9106 0x348 0x64f7 0x90c2 0x33d 0x6633 0x908e 0x354 0x676e 0x9052 0x348 0x68a9 0x9004 0x342 0x69e4 0x8fc8 0x340 0x6b1f 0x8fb8 0x348 0x6c5b 0x8fb4 0x35a 0x6d96 0x8fa2 0x348 0x6ed1 0x8f9c 0x355 0x700c 0x8f7d 0x34a 0x7148 0x8f41 0x35c 0x7283 0x8e7a 0x35c 0x73be 0x8d0e 0x35c 0x74f9 0x8b42 0x36f 0x7634 0x88dc 0x374 0x7770 0x8585 0x38d 0x78ab 0x8046 0x3b5 0x79e6 0x738c 0x5c8>;
		battery0_profile_t1_num = <0x64>;
		battery0_profile_t1 = <0x0 0xaa14 0x3e8 0x13b 0xa98c 0x3e8 0x276 0xa913 0x3f3 0x3b2 0xa899 0x3fc 0x4ed 0xa824 0x3e8 0x628 0xa7a9 0x3e8 0x763 0xa737 0x3e8 0x89e 0xa6c6 0x3f9 0x9da 0xa64a 0x3e8 0xb15 0xa5d8 0x3e8 0xc50 0xa566 0x3e8 0xd8b 0xa4eb 0x3d6 0xec7 0xa481 0x3f5 0x1002 0xa40b 0x3e6 0x113d 0xa398 0x3e0 0x1278 0xa32d 0x3e7 0x13b3 0xa2bc 0x3e3 0x14ef 0xa24f 0x3de 0x162a 0xa1db 0x3d9 0x1765 0xa171 0x3e8 0x18a0 0xa100 0x3d4 0x19db 0xa094 0x3d4 0x1b17 0xa027 0x3c4 0x1c52 0x9fc0 0x3d4 0x1d8d 0x9f5e 0x3d4 0x1ec8 0x9f06 0x3c8 0x2004 0x9ead 0x3d1 0x213f 0x9e4a 0x3d4 0x227a 0x9de2 0x3d4 0x23b5 0x9d70 0x3d4 0x24f0 0x9cff 0x3d4 0x262c 0x9c9a 0x3c3 0x2767 0x9c41 0x3d4 0x28a2 0x9be9 0x3d4 0x29dd 0x9b87 0x3c1 0x2b18 0x9b42 0x3d4 0x2c54 0x9af3 0x3d4 0x2d8f 0x9aad 0x3d4 0x2eca 0x9a57 0x3d4 0x3005 0x99ee 0x3d4 0x3140 0x996a 0x3d4 0x327c 0x98df 0x3d4 0x33b7 0x986a 0x3c1 0x34f2 0x9811 0x3ce 0x362d 0x97c4 0x3cb 0x3769 0x9775 0x3c4 0x38a4 0x973c 0x3d4 0x39df 0x96fd 0x3d4 0x3b1a 0x96bd 0x3c8 0x3c55 0x9687 0x3d1 0x3d91 0x9654 0x3d4 0x3ecc 0x9622 0x3cc 0x4007 0x95ef 0x3cd 0x4142 0x95bd 0x3c2 0x427d 0x9595 0x3d0 0x43b9 0x9566 0x3c9 0x44f4 0x9541 0x3d4 0x462f 0x9511 0x3d4 0x476a 0x94f5 0x3d4 0x48a6 0x94cf 0x3de 0x49e1 0x94b1 0x3f7 0x4b1c 0x9483 0x3e8 0x4c57 0x946a 0x3ee 0x4d92 0x944b 0x3f1 0x4ece 0x942e 0x3e8 0x5009 0x9414 0x3e6 0x5144 0x93ee 0x3d4 0x527f 0x93ce 0x3d4 0x53ba 0x93b5 0x3e5 0x54f6 0x9390 0x3eb 0x5631 0x9366 0x3f4 0x576c 0x9333 0x3e8 0x58a7 0x930a 0x3fb 0x59e2 0x92e2 0x3fc 0x5b1e 0x92b4 0x3fc 0x5c59 0x928e 0x40a 0x5d94 0x9268 0x3fc 0x5ecf 0x924c 0x40b 0x600b 0x9227 0x3fc 0x6146 0x9201 0x40c 0x6281 0x91d0 0x3fc 0x63bc 0x9193 0x402 0x64f7 0x9161 0x41c 0x6633 0x9126 0x413 0x676e 0x90e7 0x412 0x68a9 0x909c 0x41d 0x69e4 0x9057 0x41d 0x6b1f 0x903a 0x424 0x6c5b 0x902c 0x424 0x6d96 0x9020 0x424 0x6ed1 0x901a 0x432 0x700c 0x9007 0x438 0x7148 0x8fd9 0x438 0x7283 0x8f4b 0x442 0x73be 0x8e07 0x43d 0x74f9 0x8c40 0x460 0x7634 0x89e8 0x47a 0x7770 0x86bc 0x493 0x78ab 0x81de 0x4bc 0x79e6 0x7774 0x6e0>;
		battery0_profile_t2_num = <0x64>;
		battery0_profile_t2 = <0x0 0xaa0a 0x668 0x13b 0xa975 0x67c 0x276 0xa8ef 0x687 0x3b2 0xa871 0x680 0x4ed 0xa7fd 0x6a3 0x628 0xa77f 0x68a 0x763 0xa70c 0x688 0x89e 0xa696 0x67f 0x9da 0xa623 0x690 0xb15 0xa5ae 0x689 0xc50 0xa536 0x67c 0xd8b 0xa4c5 0x67c 0xec7 0xa455 0x67c 0x1002 0xa3e8 0x674 0x113d 0xa377 0x675 0x1278 0xa308 0x67c 0x13b3 0xa299 0x668 0x14ef 0xa22f 0x671 0x162a 0xa1be 0x66e 0x1765 0xa14d 0x655 0x18a0 0xa0e7 0x668 0x19db 0xa082 0x668 0x1b17 0xa01d 0x668 0x1c52 0x9fc2 0x668 0x1d8d 0x9f74 0x668 0x1ec8 0x9f21 0x673 0x2004 0x9ebd 0x65b 0x213f 0x9e36 0x655 0x227a 0x9da8 0x668 0x23b5 0x9d1c 0x668 0x24f0 0x9ca6 0x668 0x262c 0x9c43 0x657 0x2767 0x9c00 0x660 0x28a2 0x9bb5 0x661 0x29dd 0x9b72 0x67a 0x2b18 0x9b13 0x66c 0x2c54 0x9ab9 0x66a 0x2d8f 0x9a4f 0x670 0x2eca 0x99d6 0x67c 0x3005 0x9953 0x672 0x3140 0x98ee 0x690 0x327c 0x9891 0x690 0x33b7 0x9839 0x67c 0x34f2 0x97f0 0x682 0x362d 0x97ab 0x685 0x3769 0x9770 0x69c 0x38a4 0x973c 0x6b6 0x39df 0x96fd 0x6a4 0x3b1a 0x96c4 0x6b0 0x3c55 0x9692 0x6b8 0x3d91 0x965f 0x6ba 0x3ecc 0x9631 0x6d4 0x4007 0x9604 0x6d3 0x4142 0x95db 0x6de 0x427d 0x95ab 0x6e0 0x43b9 0x9585 0x6e9 0x44f4 0x955f 0x6f4 0x462f 0x9539 0x707 0x476a 0x9513 0x71c 0x48a6 0x94f2 0x71c 0x49e1 0x94d9 0x72b 0x4b1c 0x94ac 0x730 0x4c57 0x9493 0x749 0x4d92 0x9479 0x763 0x4ece 0x9460 0x76c 0x5009 0x9446 0x780 0x5144 0x9424 0x780 0x527f 0x940a 0x78c 0x53ba 0x93f1 0x794 0x54f6 0x93e2 0x7aa 0x5631 0x93c9 0x7c3 0x576c 0x93a9 0x7d0 0x58a7 0x937a 0x7d0 0x59e2 0x9353 0x7e7 0x5b1e 0x932d 0x7f8 0x5c59 0x9308 0x7ea 0x5d94 0x92e2 0x7f7 0x5ecf 0x92ba 0x80c 0x600b 0x9287 0x80c 0x6146 0x9246 0x7fd 0x6281 0x920e 0x820 0x63bc 0x91d2 0x811 0x64f7 0x919a 0x82a 0x6633 0x914b 0x844 0x676e 0x90fe 0x85b 0x68a9 0x90d5 0x84e 0x69e4 0x90c8 0x85c 0x6b1f 0x90bc 0x86d 0x6c5b 0x90a5 0x886 0x6d96 0x9091 0x898 0x6ed1 0x905f 0x8a4 0x700c 0x8ff3 0x8cf 0x7148 0x8eb9 0x8ee 0x7283 0x8cd5 0x921 0x73be 0x8a70 0x961 0x74f9 0x873d 0x9bf 0x7634 0x81d9 0xa3c 0x7770 0x7c24 0xa3c 0x78ab 0x7c24 0xa3c 0x79e6 0x7c24 0xa3c>;
		battery0_profile_t3_num = <0x64>;
		battery0_profile_t3 = <0x0 0xa8f2 0xac8 0x13b 0xa832 0xb0f 0x276 0xa7a5 0xb41 0x3b2 0xa727 0xb64 0x4ed 0xa6a9 0xb69 0x628 0xa62e 0xb82 0x763 0xa5b7 0xb85 0x89e 0xa541 0xb8d 0x9da 0xa4cf 0xb7c 0xb15 0xa45d 0xb7c 0xc50 0xa3ec 0xb89 0xd8b 0xa37a 0xb7e 0xec7 0xa309 0xb6b 0x1002 0xa2a0 0xb7c 0x113d 0xa22f 0xb7c 0x1278 0xa1c6 0xb7c 0x13b3 0xa155 0xb64 0x14ef 0xa0e8 0xb5e 0x162a 0xa083 0xb68 0x1765 0xa01e 0xb54 0x18a0 0x9fbe 0xb4b 0x19db 0x9f72 0xb68 0x1b17 0x9f1e 0xb58 0x1c52 0x9ec5 0xb54 0x1d8d 0x9e4d 0xb54 0x1ec8 0x9db6 0xb48 0x2004 0x9d1a 0xb40 0x213f 0x9c8e 0xb52 0x227a 0x9c14 0xb40 0x23b5 0x9baf 0xb40 0x24f0 0x9b60 0xb52 0x262c 0x9b1e 0xb65 0x2767 0x9ad2 0xb54 0x28a2 0x9a80 0xb54 0x29dd 0x9a1e 0xb7a 0x2b18 0x99ac 0xb7c 0x2c54 0x9936 0xb72 0x2d8f 0x98c6 0xb86 0x2eca 0x9861 0xb90 0x3005 0x980c 0xb95 0x3140 0x97c0 0xbaf 0x327c 0x9775 0xba8 0x33b7 0x9733 0xbb8 0x34f2 0x96f7 0xbc5 0x362d 0x96bf 0xbe0 0x3769 0x967f 0xbe0 0x38a4 0x964b 0xbf9 0x39df 0x9619 0xc1c 0x3b1a 0x95e6 0xc1c 0x3c55 0x95bd 0xc2e 0x3d91 0x958d 0xc37 0x3ecc 0x9563 0xc58 0x4007 0x9537 0xc66 0x4142 0x9511 0xc7f 0x427d 0x94eb 0xca8 0x43b9 0x94c6 0xcbb 0x44f4 0x94a7 0xcd0 0x462f 0x9484 0xcf8 0x476a 0x9468 0xce9 0x48a6 0x9447 0xd0d 0x49e1 0x942e 0xd30 0x4b1c 0x940b 0xd36 0x4c57 0x93fc 0xd62 0x4d92 0x93e8 0xd7c 0x4ece 0x93d3 0xd95 0x5009 0x93c5 0xd9a 0x5144 0x93b5 0xdac 0x527f 0x93a2 0xdc5 0x53ba 0x938c 0xdd4 0x54f6 0x9371 0xdfc 0x5631 0x934b 0xe05 0x576c 0x9325 0xe1e 0x58a7 0x9300 0xe37 0x59e2 0x92da 0xe3c 0x5b1e 0x92b4 0xe4c 0x5c59 0x9287 0xe69 0x5d94 0x924a 0xe88 0x5ecf 0x9213 0xeba 0x600b 0x91d1 0xebb 0x6146 0x9197 0xed8 0x6281 0x9157 0xf01 0x63bc 0x90fe 0xf14 0x64f7 0x90b7 0xf2b 0x6633 0x908d 0xf4d 0x676e 0x9073 0xf68 0x68a9 0x9063 0xf9b 0x69e4 0x9049 0xfcd 0x6b1f 0x9027 0xfee 0x6c5b 0x8ff1 0x1036 0x6d96 0x8f72 0x1079 0x6ed1 0x8e49 0x10c7 0x700c 0x8c6e 0x10f3 0x7148 0x89f9 0x1141 0x7283 0x868e 0x1193 0x73be 0x812c 0x1200 0x74f9 0x7fda 0x1220 0x7634 0x7fda 0x1220 0x7770 0x7fda 0x1220 0x78ab 0x7fda 0x1220 0x79e6 0x7fda 0x1220>;
		battery0_profile_t4_num = <0x64>;
		battery0_profile_t4 = <0x0 0xa88e 0x1630 0x13b 0xa7ed 0x163a 0x276 0xa75b 0x1612 0x3b2 0xa6d8 0x1618 0x4ed 0xa659 0x15f5 0x628 0xa5e4 0x15fb 0x763 0xa56b 0x15ec 0x89e 0xa4f1 0x15c1 0x9da 0xa47d 0x15b1 0xb15 0xa40b 0x1574 0xc50 0xa398 0x1575 0xd8b 0xa326 0x1569 0xec7 0xa2b6 0x1554 0x1002 0xa24b 0x1538 0x113d 0xa1d9 0x1518 0x1278 0xa170 0x1517 0x13b3 0xa0fe 0x14e2 0x14ef 0xa091 0x14e5 0x162a 0xa034 0x14cb 0x1765 0x9fdb 0x14d8 0x18a0 0x9f82 0x14ad 0x19db 0x9f29 0x14a0 0x1b17 0x9ec8 0x14b2 0x1c52 0x9e3e 0x1475 0x1d8d 0x9da5 0x1464 0x1ec8 0x9d06 0x1448 0x2004 0x9c6b 0x144f 0x213f 0x9bee 0x1441 0x227a 0x9b7c 0x1450 0x23b5 0x9b19 0x1440 0x24f0 0x9ac0 0x1462 0x262c 0x9a6b 0x1449 0x2767 0x9a19 0x1464 0x28a2 0x99b7 0x1464 0x29dd 0x995b 0x1475 0x2b18 0x98fa 0x1474 0x2c54 0x98a1 0x147e 0x2d8f 0x9848 0x149e 0x2eca 0x97f1 0x1495 0x3005 0x97a5 0x14be 0x3140 0x9759 0x14aa 0x327c 0x9717 0x14dc 0x33b7 0x96d7 0x14c8 0x34f2 0x9698 0x14d3 0x362d 0x9661 0x150e 0x3769 0x962d 0x1518 0x38a4 0x95f5 0x1527 0x39df 0x95c9 0x1540 0x3b1a 0x9596 0x1564 0x3c55 0x956d 0x157c 0x3d91 0x953f 0x1585 0x3ecc 0x9518 0x159e 0x4007 0x94e8 0x15cc 0x4142 0x94c2 0x15e5 0x427d 0x94a1 0x15f4 0x43b9 0x9480 0x1624 0x44f4 0x9465 0x1630 0x462f 0x944b 0x163d 0x476a 0x9432 0x1658 0x48a6 0x9419 0x1658 0x49e1 0x940b 0x1674 0x4b1c 0x93fa 0x16a0 0x4c57 0x93e7 0x16bd 0x4d92 0x93d1 0x16bd 0x4ece 0x93c4 0x16e4 0x5009 0x93b2 0x16f7 0x5144 0x93a0 0x171b 0x527f 0x9389 0x1733 0x53ba 0x9370 0x1732 0x54f6 0x9357 0x1767 0x5631 0x933d 0x1781 0x576c 0x9319 0x1777 0x58a7 0x92f3 0x17a4 0x59e2 0x92c6 0x1798 0x5b1e 0x929c 0x17cf 0x5c59 0x9268 0x17fc 0x5d94 0x9229 0x1805 0x5ecf 0x91e9 0x181f 0x600b 0x91aa 0x1824 0x6146 0x916a 0x1838 0x6281 0x9125 0x1843 0x63bc 0x90d9 0x184c 0x64f7 0x90a3 0x184c 0x6633 0x9081 0x1862 0x676e 0x9061 0x187b 0x68a9 0x9044 0x1886 0x69e4 0x9027 0x187e 0x6b1f 0x8ff0 0x185e 0x6c5b 0x8f94 0x189f 0x6d96 0x8ec8 0x189c 0x6ed1 0x8d0f 0x1918 0x700c 0x8abf 0x1954 0x7148 0x879e 0x185c 0x7283 0x8430 0x1860 0x73be 0x8430 0x1860 0x74f9 0x8430 0x1860 0x7634 0x8430 0x1860 0x7770 0x8430 0x1860 0x78ab 0x8430 0x1860 0x79e6 0x8430 0x1860>;
		linux,phandle = <0x7d>;
		phandle = <0x7d>;
	};

	mdp_rdma0@14001000 {
		compatible = "mediatek,mdp_rdma0";
		reg = <0x0 0x14001000 0x0 0x1000>;
		interrupts = <0x0 0xda 0x8>;
		clocks = <0x2f 0xd>;
		clock-names = "MDP_RDMA0";
		linux,phandle = <0x31>;
		phandle = <0x31>;
	};

	mdp_rdma1@14002000 {
		compatible = "mediatek,mdp_rdma1";
		reg = <0x0 0x14002000 0x0 0x1000>;
		interrupts = <0x0 0xdb 0x8>;
		linux,phandle = <0x32>;
		phandle = <0x32>;
	};

	mdp_rsz0@14003000 {
		compatible = "mediatek,mdp_rsz0";
		reg = <0x0 0x14003000 0x0 0x1000>;
		interrupts = <0x0 0xdc 0x8>;
		clocks = <0x2f 0xf>;
		clock-names = "MDP_RSZ0";
		linux,phandle = <0x33>;
		phandle = <0x33>;
	};

	mdp_rsz1@14004000 {
		compatible = "mediatek,mdp_rsz1";
		reg = <0x0 0x14004000 0x0 0x1000>;
		interrupts = <0x0 0xdd 0x8>;
		clocks = <0x2f 0x10>;
		clock-names = "MDP_RSZ1";
		linux,phandle = <0x34>;
		phandle = <0x34>;
	};

	mdp_wrot0@14005000 {
		compatible = "mediatek,mdp_wrot0";
		reg = <0x0 0x14005000 0x0 0x1000>;
		interrupts = <0x0 0xdf 0x8>;
		clocks = <0x2f 0x12>;
		clock-names = "MDP_WROT0";
		linux,phandle = <0x35>;
		phandle = <0x35>;
	};

	mdp_wdma@14006000 {
		compatible = "mediatek,mdp_wdma";
		reg = <0x0 0x14006000 0x0 0x1000>;
		interrupts = <0x0 0xe0 0x8>;
		clocks = <0x2f 0x2a>;
		clock-names = "MDP_WDMA";
		linux,phandle = <0x36>;
		phandle = <0x36>;
	};

	mdp_tdshp@14007000 {
		compatible = "mediatek,mdp_tdshp";
		reg = <0x0 0x14007000 0x0 0x1000>;
		interrupts = <0x0 0xde 0x8>;
		clocks = <0x2f 0x11>;
		clock-names = "MDP_TDSHP";
		linux,phandle = <0x37>;
		phandle = <0x37>;
	};

	mtkfb@0 {
		compatible = "mediatek,mtkfb";
		linux,phandle = <0x7e>;
		phandle = <0x7e>;
	};

	dispsys {
		compatible = "mediatek,dispsys";
		clocks = <0x2e 0x3 0x2f 0x1 0x2f 0x2 0x2f 0x3 0x2f 0x4 0x2f 0x5 0x2f 0x14 0x2f 0x15 0x2f 0x16 0x2f 0x17 0x2f 0x18 0x2f 0x19 0x2f 0x1a 0x2f 0x1b 0x2f 0x1c 0x2f 0x1d 0x2f 0x1e 0x2f 0x20 0x2f 0x21 0x2f 0x22 0x2f 0x23 0x2f 0x2d 0x2f 0x2e 0x2f 0x27 0x2f 0x29 0x42 0x2 0x42 0x16 0x15 0x36 0x40 0x42 0x43 0x42 0x44 0x42 0x5c 0x42 0x5d 0x42 0x5f 0x42 0x12 0x42 0x52 0x42 0x53 0x42 0x54 0x42 0x55 0x42 0x51>;
		clock-names = "MMSYS_MTCMOS", "MMSYS_SMI_COMMON", "MMSYS_SMI_LARB0", "MMSYS_SMI_LARB1", "MMSYS_GALS_COMM0", "MMSYS_GALS_COMM1", "MMSYS_DISP_OVL0", "MMSYS_DISP_OVL0_2L", "MMSYS_DISP_OVL1_2L", "MMSYS_DISP_RDMA0", "MMSYS_DISP_RDMA1", "MMSYS_DISP_WDMA0", "MMSYS_DISP_COLOR0", "MMSYS_DISP_CCORR0", "MMSYS_DISP_AAL0", "MMSYS_DISP_GAMMA0", "MMSYS_DISP_DITHER0", "MMSYS_DSI0_MM_CK", "MMSYS_DSI0_IF_CK", "MMSYS_DPI_MM_CK", "MMSYS_DPI_IF_CK", "MMSYS_DBI_MM_CK", "MMSYS_DBI_IF_CK", "MMSYS_26M", "MMSYS_DISP_RSZ", "TOP_MUX_MM", "TOP_MUX_DISP_PWM", "DISP_PWM", "TOP_26M", "TOP_UNIVPLL_D3_D2", "TOP_UNIVPLL_D3_D4", "TOP_OSC_D2", "TOP_OSC_D4", "TOP_OSC_D16", "MUX_DPI0", "TVDPLL_D2", "TVDPLL_D4", "TVDPLL_D8", "TVDPLL_D16", "DPI_CK";
	};

	dsi_te {
		compatible = "mediatek, DSI_TE-eint";
		status = "disabled";
		linux,phandle = <0x7f>;
		phandle = <0x7f>;
	};

	mhl@0 {
		compatible = "mediatek,extd_dev";
		linux,phandle = <0x80>;
		phandle = <0x80>;
	};

	disp_ovl0@14008000 {
		compatible = "mediatek,disp_ovl0";
		reg = <0x0 0x14008000 0x0 0x1000>;
		interrupts = <0x0 0xe1 0x8>;
	};

	disp_ovl0_2l@14009000 {
		compatible = "mediatek,disp_ovl0_2l";
		reg = <0x0 0x14009000 0x0 0x1000>;
		interrupts = <0x0 0xe2 0x8>;
	};

	disp_ovl1_2l@1400a000 {
		compatible = "mediatek,disp_ovl1_2l";
		reg = <0x0 0x1400a000 0x0 0x1000>;
		interrupts = <0x0 0xe3 0x8>;
	};

	disp_rdma0@1400b000 {
		compatible = "mediatek,disp_rdma0";
		reg = <0x0 0x1400b000 0x0 0x1000>;
		interrupts = <0x0 0xe4 0x8>;
	};

	disp_rdma1@1400c000 {
		compatible = "mediatek,disp_rdma1";
		reg = <0x0 0x1400c000 0x0 0x1000>;
		interrupts = <0x0 0xe5 0x8>;
	};

	disp_wdma0@1400d000 {
		compatible = "mediatek,disp_wdma0";
		reg = <0x0 0x1400d000 0x0 0x1000>;
		interrupts = <0x0 0xe6 0x8>;
	};

	disp_color0@1400e000 {
		compatible = "mediatek,disp_color0";
		reg = <0x0 0x1400e000 0x0 0x1000>;
		interrupts = <0x0 0xe7 0x8>;
		clocks = <0x2f 0x1a>;
		clock-names = "MDP_COLOR";
		linux,phandle = <0x3a>;
		phandle = <0x3a>;
	};

	disp_ccorr0@1400f000 {
		compatible = "mediatek,disp_ccorr0";
		reg = <0x0 0x1400f000 0x0 0x1000>;
		interrupts = <0x0 0xe8 0x8>;
	};

	disp_aal0@14010000 {
		compatible = "mediatek,disp_aal0";
		reg = <0x0 0x14010000 0x0 0x1000>;
		interrupts = <0x0 0xe9 0x8>;
		aal_support = <0x1>;
		linux,phandle = <0x81>;
		phandle = <0x81>;
	};

	disp_gamma0@14011000 {
		compatible = "mediatek,disp_gamma0";
		reg = <0x0 0x14011000 0x0 0x1000>;
		interrupts = <0x0 0xea 0x8>;
	};

	disp_dither0@14012000 {
		compatible = "mediatek,disp_dither0";
		reg = <0x0 0x14012000 0x0 0x1000>;
		interrupts = <0x0 0xeb 0x8>;
	};

	disp_split@14013000 {
		compatible = "mediatek,disp_split";
		reg = <0x0 0x14013000 0x0 0x1000>;
	};

	dsi0@14014000 {
		compatible = "mediatek,dsi0";
		reg = <0x0 0x14014000 0x0 0x1000>;
		interrupts = <0x0 0xec 0x8>;
	};

	dpi0@14015000 {
		compatible = "mediatek,dpi0";
		reg = <0x0 0x14015000 0x0 0x1000>;
		interrupts = <0x0 0xed 0x8>;
	};

	disp_mutex@14016000 {
		compatible = "mediatek,disp_mutex";
		reg = <0x0 0x14016000 0x0 0x1000>;
		interrupts = <0x0 0xd9 0x8>;
		linux,phandle = <0x30>;
		phandle = <0x30>;
	};

	smi_larb0@14017000 {
		compatible = "mediatek,smi_larb0";
		reg = <0x0 0x14017000 0x0 0x1000>;
		interrupts = <0x0 0xf0 0x8>;
		clocks = <0x2e 0x3 0x2f 0x2>;
		clock-names = "mtcmos-mm", "mm-larb0";
		linux,phandle = <0x3f>;
		phandle = <0x3f>;
	};

	smi_common@14019000 {
		compatible = "mediatek,smi_common";
		reg = <0x0 0x14019000 0x0 0x1000>;
		larbs = <0x3f 0x44 0x45 0x46 0x47 0x48 0x49>;
		mmsys_config = <0x2f>;
		clocks = <0x2e 0x3 0x2f 0x4 0x2f 0x5 0x2f 0x1 0x42 0x2 0x42 0x3 0x42 0x23 0x42 0x2c 0x42 0x2d 0x42 0x6f 0x42 0x70 0x42 0x40>;
		clock-names = "mtcmos-mm", "smi-common-gals-comm0", "smi-common-gals-comm1", "smi-common", "MMDVFS_CLK_MUX_TOP_MM_SEL", "MMDVFS_CLK_MUX_TOP_CAM_SEL", "MMDVFS_CLK_MUX_TOP_IMG_SEL", "mmdvfs_clk_syspll_d2_ck", "mmdvfs_clk_syspll_d3_ck", "mmdvfs_clk_mmpll_d6_ck", "mmdvfs_clk_mmpll_d7_ck", "mmdvfs_clk_univpll_d2_d2_ck";
	};

	mmdvfs_pmqos {
		compatible = "mediatek,mmdvfs_pmqos";
		mm_step0 = <0x1c2 0x1 0x0 0x6>;
		mm_step1 = <0x138 0x1 0x0 0x7>;
		cam_step0 = <0x222 0x1 0x1 0x3>;
		cam_step1 = <0x16c 0x1 0x1 0x4>;
		img_step0 = <0x20d 0x1 0x2 0x5>;
		img_step1 = <0x16c 0x1 0x2 0x4>;
		vopp_steps = <0x0 0x1>;
		disp_freq = "mm_step0", "mm_step1";
		mdp_freq = "mm_step0", "mm_step1";
		cam_freq = "cam_step0", "cam_step1";
		img_freq = "img_step0", "img_step1";
		vdec_freq = "mm_step0", "mm_step1";
		venc_freq = "mm_step0", "mm_step1";
		clocks = <0x42 0x2 0x42 0x3 0x42 0x23 0x42 0x2c 0x42 0x2d 0x42 0x6f 0x42 0x70 0x42 0x40>;
		clock-names = "mmdvfs_clk_mux_top_mm_sel", "mmdvfs_clk_mux_top_cam_sel", "mmdvfs_clk_mux_top_img_sel", "mmdvfs_clk_syspll_d2_ck", "mmdvfs_clk_syspll_d3_ck", "mmdvfs_clk_mmpll_d6_ck", "mmdvfs_clk_mmpll_d7_ck", "mmdvfs_clk_univpll_d2_d2_ck";
	};

	disp_rsz@1401a000 {
		compatible = "mediatek,disp_rsz";
		reg = <0x0 0x1401a000 0x0 0x1000>;
		interrupts = <0x0 0xf1 0x8>;
	};

	mdp_aal@1401b000 {
		compatible = "mediatek,mdp_aal";
		reg = <0x0 0x1401b000 0x0 0x1000>;
		interrupts = <0x0 0xf2 0x8>;
		clocks = <0x2f 0x2b>;
		clock-names = "MDP_AAL";
		linux,phandle = <0x38>;
		phandle = <0x38>;
	};

	mdp_ccorr@1401c000 {
		compatible = "mediatek,mdp_ccorr";
		reg = <0x0 0x1401c000 0x0 0x1000>;
		interrupts = <0x0 0xf3 0x8>;
		clocks = <0x2f 0x2c>;
		clock-names = "MDP_CCORR";
		linux,phandle = <0x39>;
		phandle = <0x39>;
	};

	dbi@1401d000 {
		compatible = "mediatek,dbi";
		reg = <0x0 0x1401d000 0x0 0x1000>;
		interrupts = <0x0 0xf4 0x8>;
	};

	i2c@1401e000 {
		compatible = "mediatek,i2c";
		reg = <0x0 0x1401e000 0x0 0x1000>;
	};

	dsi1@1401f000 {
		compatible = "mediatek,dsi1";
		reg = <0x0 0x1401f000 0x0 0x1000>;
	};

	mdp_wrot1@14020000 {
		compatible = "mediatek,mdp_wrot1";
		reg = <0x0 0x14020000 0x0 0x1000>;
	};

	vdec_gcon@16000000 {
		compatible = "mediatek,vdec_gcon", "syscon";
		reg = <0x0 0x16000000 0x0 0x1000>;
		clocks = <0x2e 0x3 0x2e 0xd 0x2e 0x6 0x4a 0x1 0x4b 0x2>;
		clock-names = "MT_SCP_SYS_DIS", "MT_SCP_SYS_VDE", "MT_SCP_SYS_VEN", "MT_CG_VDEC", "MT_CG_VENC";
		#clock-cells = <0x1>;
		linux,phandle = <0x4a>;
		phandle = <0x4a>;
	};

	smi_larb1@16010000 {
		compatible = "mediatek,smi_larb1";
		reg = <0x0 0x16010000 0x0 0x1000>;
		interrupts = <0x0 0x127 0x8>;
		clocks = <0x2e 0xd 0x4a 0x1 0x4a 0x2>;
		clock-names = "mtcmos-vde", "vdec-vdec", "vdec-larb1";
		linux,phandle = <0x44>;
		phandle = <0x44>;
	};

	vdec@16020000 {
		compatible = "mediatek,vdec";
		reg = <0x0 0x16020000 0x0 0x10000>;
		interrupts = <0x0 0xfa 0x8>;
	};

	vdtop@16020000 {
		compatible = "mediatek,vdtop";
		reg = <0x0 0x16020000 0x0 0x1000>;
	};

	vld@16021000 {
		compatible = "mediatek,vld";
		reg = <0x0 0x16021000 0x0 0x1000>;
	};

	vld_top@16021800 {
		compatible = "mediatek,vld_top";
		reg = <0x0 0x16021800 0x0 0x1000>;
	};

	mc@16022000 {
		compatible = "mediatek,mc";
		reg = <0x0 0x16022000 0x0 0x1000>;
	};

	avc_vld@16023000 {
		compatible = "mediatek,avc_vld";
		reg = <0x0 0x16023000 0x0 0x1000>;
	};

	avc_mv@16024000 {
		compatible = "mediatek,avc_mv";
		reg = <0x0 0x16024000 0x0 0x1000>;
	};

	vdec_pp@16025000 {
		compatible = "mediatek,vdec_pp";
		reg = <0x0 0x16025000 0x0 0x1000>;
	};

	hevc_vld@16028000 {
		compatible = "mediatek,hevc_vld";
		reg = <0x0 0x16028000 0x0 0x1000>;
	};

	vp8_vld@16026800 {
		compatible = "mediatek,vp8_vld";
		reg = <0x0 0x16026800 0x0 0x1000>;
	};

	vp6@16027000 {
		compatible = "mediatek,vp6";
		reg = <0x0 0x16027000 0x0 0x1000>;
	};

	vld2@16027800 {
		compatible = "mediatek,vld2";
		reg = <0x0 0x16027800 0x0 0x1000>;
	};

	mc_vmmu@16028000 {
		compatible = "mediatek,mc_vmmu";
		reg = <0x0 0x16028000 0x0 0x1000>;
	};

	pp_vmmu@16029000 {
		compatible = "mediatek,pp_vmmu";
		reg = <0x0 0x16029000 0x0 0x1000>;
	};

	venc_gcon@17000000 {
		compatible = "mediatek,venc_gcon", "syscon";
		reg = <0x0 0x17000000 0x0 0x1000>;
		#clock-cells = <0x1>;
		linux,phandle = <0x4b>;
		phandle = <0x4b>;
	};

	smi_larb4@17010000 {
		compatible = "mediatek,smi_larb4";
		reg = <0x0 0x17010000 0x0 0x1000>;
		interrupts = <0x0 0xf8 0x8>;
		clocks = <0x2e 0x6 0x4b 0x1 0x4b 0x2 0x4b 0x3>;
		clock-names = "mtcmos-ven", "venc-larb4", "venc-venc", "venc-jpgenc";
		linux,phandle = <0x47>;
		phandle = <0x47>;
	};

	venc@17020000 {
		compatible = "mediatek,venc";
		reg = <0x0 0x17020000 0x0 0x1000>;
		interrupts = <0x0 0xf7 0x8>;
		linux,phandle = <0x3b>;
		phandle = <0x3b>;
	};

	venc_jpg@17030000 {
		compatible = "mediatek,venc_jpg";
		reg = <0x0 0x17030000 0x0 0x1000>;
		interrupts = <0x0 0xf9 0x8>;
		clocks = <0x4b 0x3>;
		clock-names = "MT_CG_VENC_JPGENC";
	};

	mbist@17040000 {
		compatible = "mediatek,mbist";
		reg = <0x0 0x17040000 0x0 0x1000>;
	};

	mjc_config@12000000 {
		compatible = "mediatek,mjc_config";
		reg = <0x0 0x12000000 0x0 0x1000>;
	};

	mjc_top@12001000 {
		compatible = "mediatek,mjc_top";
		reg = <0x0 0x12001000 0x0 0x1000>;
	};

	imgsys1_dfp@1502e000 {
		compatible = "mediatek,imgsys1_dfp";
		reg = <0x0 0x1502e000 0x0 0x1000>;
	};

	imgsys@15020000 {
		compatible = "mediatek,imgsys", "syscon";
		reg = <0x0 0x15020000 0x0 0x1000>;
		#clock-cells = <0x1>;
		clocks = <0x4c 0xa 0x4c 0x8>;
		clock-names = "DIP_CG_IMG_LARB5", "DIP_CG_IMG_DIP";
		linux,phandle = <0x4c>;
		phandle = <0x4c>;
	};

	imgsyscq@15020000 {
		compatible = "mediatek,imgsyscq";
		reg = <0x0 0x15020000 0x0 0x10>;
	};

	smi_larb2@1502f000 {
		compatible = "mediatek,smi_larb2";
		reg = <0x0 0x1502f000 0x0 0x1000>;
		interrupts = <0x0 0x107 0x8>;
		clocks = <0x2e 0x5 0x2f 0xa 0x4c 0x9>;
		clock-names = "mtcmos-isp", "gals-ipu2mm", "img-larb2";
		linux,phandle = <0x45>;
		phandle = <0x45>;
	};

	smi_larb5@15021000 {
		compatible = "mediatek,smi_larb5";
		reg = <0x0 0x15021000 0x0 0x1000>;
		interrupts = <0x0 0x10b 0x8>;
		clocks = <0x2e 0x5 0x2f 0x8 0x4c 0xa>;
		clock-names = "mtcmos-isp", "gals-img2mm", "img-larb5";
		linux,phandle = <0x48>;
		phandle = <0x48>;
	};

	dip1@15022000 {
		compatible = "mediatek,dip1";
		reg = <0x0 0x15022000 0x0 0x6000>;
		interrupts = <0x0 0x10c 0x8>;
	};

	dip2@15023000 {
		compatible = "mediatek,dip2";
		reg = <0x0 0x15023000 0x0 0x1000>;
	};

	dip3@15024000 {
		compatible = "mediatek,dip3";
		reg = <0x0 0x15024000 0x0 0x1000>;
	};

	dip4@15025000 {
		compatible = "mediatek,dip4";
		reg = <0x0 0x15025000 0x0 0x1000>;
	};

	dip5@15026000 {
		compatible = "mediatek,dip5";
		reg = <0x0 0x15026000 0x0 0x1000>;
	};

	dip6@15027000 {
		compatible = "mediatek,dip6";
		reg = <0x0 0x15027000 0x0 0x1000>;
	};

	dpe@15028000 {
		compatible = "mediatek,dpe";
		reg = <0x0 0x15028000 0x0 0x1000>;
		interrupts = <0x0 0x10e 0x8>;
		clocks = <0x4c 0x6>;
		clock-names = "DPE_CG_IMG_DPE";
	};

	dpe_dma@15028000 {
		compatible = "mediatek,dpe_dma";
		reg = <0x0 0x15028000 0x0 0x1000>;
	};

	rsc@15029000 {
		compatible = "mediatek,rsc";
		reg = <0x0 0x15029000 0x0 0x1000>;
		interrupts = <0x0 0x10f 0x8>;
		clocks = <0x4c 0x5>;
		clock-names = "RSC_CLK_IMG_RSC";
	};

	wpe_a@1502a000 {
		compatible = "mediatek,wpe_a";
		reg = <0x0 0x1502a000 0x0 0x1000>;
		interrupts = <0x0 0x111 0x8>;
		clocks = <0x4c 0x3>;
		clock-names = "WPE_CLK_IMG_WPE_A";
	};

	wpe_b@1502d000 {
		compatible = "mediatek,wpe_b";
		reg = <0x0 0x1502d000 0x0 0x1000>;
		interrupts = <0x0 0x112 0x8>;
		clocks = <0x4c 0x2>;
		clock-names = "WPE_CLK_IMG_WPE_B";
	};

	fdvt@1502b000 {
		compatible = "mediatek,fdvt";
		reg = <0x0 0x1502b000 0x0 0x1000>;
		interrupts = <0x0 0x10d 0x8>;
		clocks = <0x4c 0x7>;
		clock-names = "FD_CLK_IMG_FDVT";
	};

	fdvt_dma@1502b000 {
		compatible = "mediatek,fdvt_dma";
		reg = <0x0 0x1502b000 0x0 0x1000>;
	};

	mfb@1502e000 {
		compatible = "mediatek,mfb";
		reg = <0x0 0x1502e000 0x0 0x1000>;
		interrupts = <0x0 0x114 0x8>;
		clocks = <0x4c 0x4>;
		clock-names = "MFB_CLK_IMG_MFB";
	};

	tsf@1a0a1000 {
		compatible = "mediatek,tsf";
		reg = <0x0 0x1a0a1000 0x0 0x1000>;
		interrupts = <0x0 0x109 0x8>;
		clocks = <0x4d 0x9>;
		clock-names = "TSF_CAMSYS_TSF_CGPDN";
	};

	owe@1502c000 {
		compatible = "mediatek,owe";
		reg = <0x0 0x1502c000 0x0 0x1000>;
		interrupts = <0x0 0x115 0x8>;
		clocks = <0x4c 0x1>;
		clock-names = "OWE_CLK_IMG_OWE";
	};

	owe_dma@1502c000 {
		compatible = "mediatek,owe_dma";
		reg = <0x0 0x1502c000 0x0 0x1000>;
	};

	eaf@1502d000 {
		compatible = "mediatek,eaf";
		reg = <0x0 0x1502d000 0x0 0x1000>;
	};

	imgsys1_vad@1502e000 {
		compatible = "mediatek,imgsys1_vad";
		reg = <0x0 0x1502e000 0x0 0x1000>;
	};

	camsys@1a000000 {
		compatible = "mediatek,camsys", "syscon";
		reg = <0x0 0x1a000000 0x0 0x1000>;
		#clock-cells = <0x1>;
		clocks = <0x2e 0x3 0x2e 0x5 0x2e 0x9 0x4d 0x3 0x4d 0x4 0x4d 0x6 0x4d 0x7 0x4d 0x8>;
		clock-names = "ISP_SCP_SYS_DIS", "ISP_SCP_SYS_ISP", "ISP_SCP_SYS_CAM", "CAMSYS_CAM_CGPDN", "CAMSYS_CAMTG_CGPDN", "CAMSYS_CAMSV0_CGPDN", "CAMSYS_CAMSV1_CGPDN", "CAMSYS_CAMSV2_CGPDN";
		linux,phandle = <0x4d>;
		phandle = <0x4d>;
	};

	ipu_conn@19000000 {
		compatible = "mediatek,ipu_conn", "syscon";
		reg = <0x0 0x19000000 0x0 0x1000>;
		#clock-cells = <0x1>;
		linux,phandle = <0x50>;
		phandle = <0x50>;
	};

	ipu_adl@19010000 {
		compatible = "mediatek,ipu_adl", "syscon";
		reg = <0x0 0x19010000 0x0 0x1000>;
		#clock-cells = <0x1>;
		linux,phandle = <0x82>;
		phandle = <0x82>;
	};

	ipu0@19180000 {
		compatible = "mediatek,ipu0", "syscon";
		reg = <0x0 0x19180000 0x0 0x1000>;
		interrupts = <0x0 0x124 0x8>;
		#clock-cells = <0x1>;
		linux,phandle = <0x4e>;
		phandle = <0x4e>;
	};

	ipu1@19280000 {
		compatible = "mediatek,ipu1", "syscon";
		reg = <0x0 0x19280000 0x0 0x1000>;
		interrupts = <0x0 0x125 0x8>;
		#clock-cells = <0x1>;
		linux,phandle = <0x4f>;
		phandle = <0x4f>;
	};

	vpu_core0@0x19100000 {
		compatible = "mediatek,vpu_core0";
		reg = <0x0 0x19100000 0x0 0x94000>;
		interrupts = <0x0 0x124 0x8>;
		clocks = <0x42 0x24 0x42 0x25 0x42 0x26 0x42 0x27 0x4e 0x1 0x4e 0x2 0x4e 0x3 0x4f 0x1 0x4f 0x2 0x4f 0x3 0x50 0x1 0x50 0x7 0x50 0x8 0x50 0x9 0x50 0xa 0x50 0xb 0x50 0xc 0x50 0xd 0x50 0xe 0x50 0xf 0x50 0x1 0x50 0x2 0x50 0x3 0x50 0x4 0x50 0x5 0x50 0x6 0x42 0x6f 0x42 0x70 0x42 0x3d 0x42 0x2d 0x42 0x40 0x42 0x30 0x42 0x43 0x42 0x34 0x2f 0xa 0x2f 0x7 0x2f 0x5 0x2f 0x4 0x2f 0x1 0x2e 0x3 0x2e 0xe 0x2e 0xf 0x2e 0x10 0x2e 0x11 0x2e 0x12>;
		clock-names = "clk_top_dsp_sel", "clk_top_dsp1_sel", "clk_top_dsp2_sel", "clk_top_ipu_if_sel", "clk_ipu_core0_jtag_cg", "clk_ipu_core0_axi_m_cg", "clk_ipu_core0_ipu_cg", "clk_ipu_core1_jtag_cg", "clk_ipu_core1_axi_m_cg", "clk_ipu_core1_ipu_cg", "clk_ipu_adl_cabgen", "clk_ipu_conn_dap_rx_cg", "clk_ipu_conn_apb2axi_cg", "clk_ipu_conn_apb2ahb_cg", "clk_ipu_conn_ipu_cab1to2", "clk_ipu_conn_ipu1_cab1to2", "clk_ipu_conn_ipu2_cab1to2", "clk_ipu_conn_cab3to3", "clk_ipu_conn_cab2to1", "clk_ipu_conn_cab3to1_slice", "clk_ipu_conn_ipu_cg", "clk_ipu_conn_ahb_cg", "clk_ipu_conn_axi_cg", "clk_ipu_conn_isp_cg", "clk_ipu_conn_cam_adl_cg", "clk_ipu_conn_img_adl_cg", "clk_top_mmpll_d6", "clk_top_mmpll_d7", "clk_top_univpll_d3", "clk_top_syspll_d3", "clk_top_univpll_d2_d2", "clk_top_syspll_d2_d2", "clk_top_univpll_d3_d2", "clk_top_syspll_d3_d2", "clk_mmsys_gals_ipu2mm", "clk_mmsys_gals_ipu12mm", "clk_mmsys_gals_comm1", "clk_mmsys_gals_comm0", "clk_mmsys_smi_common", "mtcmos_dis", "mtcmos_vpu_top", "mtcmos_vpu_core0_dormant", "mtcmos_vpu_core0_shutdown", "mtcmos_vpu_core1_dormant", "mtcmos_vpu_core1_shutdown";
	};

	vpu_core1@0x19200000 {
		compatible = "mediatek,vpu_core1";
		reg = <0x0 0x19200000 0x0 0x94000>;
		interrupts = <0x0 0x125 0x8>;
	};

	smi_larb3@1a002000 {
		compatible = "mediatek,smi_larb3";
		reg = <0x0 0x1a002000 0x0 0x1000>;
		clocks = <0x2e 0x9 0x2f 0x7 0x4d 0xa>;
		clock-names = "mtcmos-cam", "gals-ipu12mm", "cam-larb3";
		linux,phandle = <0x46>;
		phandle = <0x46>;
	};

	smi_larb6@1a001000 {
		compatible = "mediatek,smi_larb6";
		reg = <0x0 0x1a001000 0x0 0x1000>;
		clocks = <0x2e 0x9 0x2f 0x9 0x4d 0x1>;
		clock-names = "mtcmos-cam", "gals-cam2mm", "cam-larb6";
		linux,phandle = <0x49>;
		phandle = <0x49>;
	};

	cam1@1a003000 {
		compatible = "mediatek,cam1";
		reg = <0x0 0x1a003000 0x0 0x1000>;
		interrupts = <0x0 0xfd 0x8>;
	};

	cam2@1a004000 {
		compatible = "mediatek,cam2";
		reg = <0x0 0x1a004000 0x0 0x2000>;
		interrupts = <0x0 0xfe 0x8>;
	};

	cam3@1a006000 {
		compatible = "mediatek,cam3";
		reg = <0x0 0x1a006000 0x0 0x2000>;
		interrupts = <0x0 0xff 0x8>;
	};

	cam4@1a008000 {
		compatible = "mediatek,cam4";
		reg = <0x0 0x1a008000 0x0 0x2000>;
		interrupts = <0x0 0x100 0x8>;
	};

	camsv1@1a050000 {
		compatible = "mediatek,camsv1";
		reg = <0x0 0x1a050000 0x0 0x1000>;
		interrupts = <0x0 0x102 0x8>;
	};

	camsv2@1a051000 {
		compatible = "mediatek,camsv2";
		reg = <0x0 0x1a051000 0x0 0x1000>;
		interrupts = <0x0 0x103 0x8>;
	};

	camsv3@1a052000 {
		compatible = "mediatek,camsv3";
		reg = <0x0 0x1a052000 0x0 0x1000>;
		interrupts = <0x0 0x104 0x8>;
	};

	camsv4@1a053000 {
		compatible = "mediatek,camsv4";
		reg = <0x0 0x1a053000 0x0 0x1000>;
		interrupts = <0x0 0x105 0x8>;
	};

	camsv5@1a054000 {
		compatible = "mediatek,camsv5";
		reg = <0x0 0x1a054000 0x0 0x1000>;
	};

	camsv6@1a055000 {
		compatible = "mediatek,camsv6";
		reg = <0x0 0x1a055000 0x0 0x1000>;
	};

	seninf1@1a040000 {
		compatible = "mediatek,seninf1";
		reg = <0x0 0x1a040000 0x0 0x1000>;
	};

	seninf2@1a041000 {
		compatible = "mediatek,seninf2";
		reg = <0x0 0x1a041000 0x0 0x1000>;
	};

	seninf3@1a042000 {
		compatible = "mediatek,seninf3";
		reg = <0x0 0x1a042000 0x0 0x1000>;
	};

	seninf4@1a043000 {
		compatible = "mediatek,seninf4";
		reg = <0x0 0x1a043000 0x0 0x1000>;
	};

	seninf5@1a044000 {
		compatible = "mediatek,seninf5";
		reg = <0x0 0x1a044000 0x0 0x1000>;
	};

	seninf6@1a045000 {
		compatible = "mediatek,seninf6";
		reg = <0x0 0x1a045000 0x0 0x1000>;
	};

	seninf7@1a046000 {
		compatible = "mediatek,seninf7";
		reg = <0x0 0x1a046000 0x0 0x1000>;
	};

	seninf8@1a047000 {
		compatible = "mediatek,seninf8";
		reg = <0x0 0x1a047000 0x0 0x1000>;
	};

	seninf_top@1a040000 {
		compatible = "mediatek,seninf_top";
		reg = <0x0 0x1a040000 0x0 0x1000>;
		clocks = <0x2e 0x3 0x2e 0x9 0x4d 0x5 0x42 0x1c 0x42 0x5 0x42 0x1e 0x42 0x28 0x42 0x29 0x40 0x42 0x65 0x42 0x45 0x42 0x64 0x42 0x60 0x42 0x66 0x42 0x67>;
		clock-names = "SCP_SYS_DIS", "SCP_SYS_CAM", "CAMSYS_SENINF_CGPDN", "TOP_MUX_SENINF", "TOP_MUX_CAMTG", "TOP_MUX_CAMTG2", "TOP_MUX_CAMTG3", "TOP_MUX_CAMTG4", "TOP_CLK26M", "TOP_UNIVP_192M_D8", "TOP_UNIVPLL_D3_D8", "TOP_UNIVP_192M_D4", "TOP_F26M_CK_D2", "TOP_UNIVP_192M_D16", "TOP_UNIVP_192M_D32";
	};

	kd_camera_hw1@1a040000 {
		compatible = "mediatek,imgsensor";
		linux,phandle = <0x83>;
		phandle = <0x83>;
	};

	flashlight_core {
		compatible = "mediatek,flashlight_core";
		linux,phandle = <0x84>;
		phandle = <0x84>;
	};

	flashlights_mt6370 {
		compatible = "mediatek,flashlights_mt6370";
		decouple = <0x0>;
		linux,phandle = <0x85>;
		phandle = <0x85>;

		channel@1 {
			type = <0x0>;
			ct = <0x0>;
			part = <0x0>;
		};

		channel@2 {
			type = <0x0>;
			ct = <0x1>;
			part = <0x0>;
		};
	};

	flashlights_lm3644 {
		compatible = "mediatek,flashlights_lm3644";
		linux,phandle = <0x86>;
		phandle = <0x86>;
	};

	ccu@1a0a0000 {
		compatible = "mediatek,ccu";
		reg = <0x0 0x1a0a1000 0x0 0x1000>;
		interrupts = <0x0 0x108 0x8>;
		clocks = <0x4d 0x9 0x2f 0x6>;
		clock-names = "CCU_CLK_CAM_CCU", "CCU_CLK_MMSYS_CCU";
	};

	alc@60000000 {
		compatible = "mediatek,alc";
		reg = <0x0 0x60000000 0x0 0x1000>;
	};

	md_config@80000000 {
		compatible = "mediatek,md_config";
		reg = <0x0 0x80000000 0x0 0x1000>;
	};

	md_uart0@80010000 {
		compatible = "mediatek,md_uart0";
		reg = <0x0 0x80010000 0x0 0x1000>;
	};

	md_p_dma@80020000 {
		compatible = "mediatek,md_p_dma";
		reg = <0x0 0x80020000 0x0 0x1000>;
	};

	md_gpt@80030000 {
		compatible = "mediatek,md_gpt";
		reg = <0x0 0x80030000 0x0 0x1000>;
	};

	simif1@80040000 {
		compatible = "mediatek,simif1";
		reg = <0x0 0x80040000 0x0 0x1000>;
	};

	simif2@80050000 {
		compatible = "mediatek,simif2";
		reg = <0x0 0x80050000 0x0 0x1000>;
	};

	md_peri_misc@80060000 {
		compatible = "mediatek,md_peri_misc";
		reg = <0x0 0x80060000 0x0 0x1000>;
	};

	md_cirq@f0070000 {
		compatible = "mediatek,md_cirq";
		reg = <0x0 0xf0070000 0x0 0x1000>;
	};

	md_debug1@80080000 {
		compatible = "mediatek,md_debug1";
		reg = <0x0 0x80080000 0x0 0x1000>;
	};

	md_debug2@80090000 {
		compatible = "mediatek,md_debug2";
		reg = <0x0 0x80090000 0x0 0x1000>;
	};

	md_debug3@800a0000 {
		compatible = "mediatek,md_debug3";
		reg = <0x0 0x800a0000 0x0 0x1000>;
	};

	mdpar_dbgmon@800b0000 {
		compatible = "mediatek,mdpar_dbgmon";
		reg = <0x0 0x800b0000 0x0 0x1000>;
	};

	md_peri_clk_ctl@800c0000 {
		compatible = "mediatek,md_peri_clk_ctl";
		reg = <0x0 0x800c0000 0x0 0x1000>;
	};

	md_topsm@f00d0000 {
		compatible = "mediatek,md_topsm";
		reg = <0x0 0xf00d0000 0x0 0x1000>;
	};

	md_ost@f00e0000 {
		compatible = "mediatek,md_ost";
		reg = <0x0 0xf00e0000 0x0 0x1000>;
	};

	md_rgu@f00f0000 {
		compatible = "mediatek,md_rgu";
		reg = <0x0 0xf00f0000 0x0 0x1000>;
		interrupts = <0x0 0x11b 0x2>;
	};

	md_i2c@80100000 {
		compatible = "mediatek,md_i2c";
		reg = <0x0 0x80100000 0x0 0x1000>;
	};

	md_eint@80110000 {
		compatible = "mediatek,md_eint";
		reg = <0x0 0x80110000 0x0 0x1000>;
	};

	md_clkctl@80120000 {
		compatible = "mediatek,md_clkctl";
		reg = <0x0 0x80120000 0x0 0x1000>;
	};

	md_global_con_dcm@80130000 {
		compatible = "mediatek,md_global_con_dcm";
		reg = <0x0 0x80130000 0x0 0x1000>;
	};

	md_pll_mixedsys@80140000 {
		compatible = "mediatek,md_pll_mixedsys";
		reg = <0x0 0x80140000 0x0 0x1000>;
	};

	md_clksw@80150000 {
		compatible = "mediatek,md_clksw";
		reg = <0x0 0x80150000 0x0 0x1000>;
	};

	a7_ost@f0160000 {
		compatible = "mediatek,a7_ost";
		reg = <0x0 0xf0160000 0x0 0x1000>;
	};

	md_lite_gpt@80170000 {
		compatible = "mediatek,md_lite_gpt";
		reg = <0x0 0x80170000 0x0 0x1000>;
	};

	mdperi_mbist_config@801a0000 {
		compatible = "mediatek,mdperi_mbist_config";
		reg = <0x0 0x801a0000 0x0 0x1000>;
	};

	md_sdf_top@801b0000 {
		compatible = "mediatek,md_sdf_top";
		reg = <0x0 0x801b0000 0x0 0x1000>;
	};

	psmcu_misc@80200000 {
		compatible = "mediatek,psmcu_misc";
		reg = <0x0 0x80200000 0x0 0x1000>;
	};

	psmcu_busmon@80210000 {
		compatible = "mediatek,psmcu_busmon";
		reg = <0x0 0x80210000 0x0 0x1000>;
	};

	md_pcm@80220000 {
		compatible = "mediatek,md_pcm";
		reg = <0x0 0x80220000 0x0 0x1000>;
	};

	psmcu_mbist_config@80240000 {
		compatible = "mediatek,psmcu_mbist_config";
		reg = <0x0 0x80240000 0x0 0x1000>;
	};

	md_elm@80250000 {
		compatible = "mediatek,md_elm";
		reg = <0x0 0x80250000 0x0 0x1000>;
	};

	md_abm@80260000 {
		compatible = "mediatek,md_abm";
		reg = <0x0 0x80260000 0x0 0x1000>;
	};

	md_soe@80310000 {
		compatible = "mediatek,md_soe";
		reg = <0x0 0x80310000 0x0 0x1000>;
		interrupts = <0x0 0x11e 0x8>;
	};

	md_infra_busmon@80320000 {
		compatible = "mediatek,md_infra_busmon";
		reg = <0x0 0x80320000 0x0 0x1000>;
	};

	md_uart1@80330000 {
		compatible = "mediatek,md_uart1";
		reg = <0x0 0x80330000 0x0 0x1000>;
	};

	md_uart2@80340000 {
		compatible = "mediatek,md_uart2";
		reg = <0x0 0x80340000 0x0 0x1000>;
	};

	mdinfra_mbist_config@80350000 {
		compatible = "mediatek,mdinfra_mbist_config";
		reg = <0x0 0x80350000 0x0 0x1000>;
	};

	mdsys_mbist_config@80360000 {
		compatible = "mediatek,mdsys_mbist_config";
		reg = <0x0 0x80360000 0x0 0x1000>;
	};

	mdsmicfg@803a0000 {
		compatible = "mediatek,mdsmicfg";
		reg = <0x0 0x803a0000 0x0 0x1000>;
	};

	mdinfra_misc@803b0000 {
		compatible = "mediatek,mdinfra_misc";
		reg = <0x0 0x803b0000 0x0 0x1000>;
	};

	md_bus_recoder@803c0000 {
		compatible = "mediatek,md_bus_recoder";
		reg = <0x0 0x803c0000 0x0 0x1000>;
	};

	md_ppc_top@803d0000 {
		compatible = "mediatek,md_ppc_top";
		reg = <0x0 0x803d0000 0x0 0x1000>;
	};

	a7_wdt@f0400000 {
		compatible = "mediatek,a7_wdt";
		reg = <0x0 0xf0400000 0x0 0x1000>;
	};

	a7_mbist_config@f0410000 {
		compatible = "mediatek,a7_mbist_config";
		reg = <0x0 0xf0410000 0x0 0x1000>;
	};

	a7_cirq@f0420000 {
		compatible = "mediatek,a7_cirq";
		reg = <0x0 0xf0420000 0x0 0x1000>;
	};

	pf_bsi_apb1@80200000 {
		compatible = "mediatek,pf_bsi_apb1";
		reg = <0x0 0x80200000 0x0 0x1000>;
	};

	pf_bsi_apb2@80201000 {
		compatible = "mediatek,pf_bsi_apb2";
		reg = <0x0 0x80201000 0x0 0x1000>;
	};

	rfic1_bsispi@80202000 {
		compatible = "mediatek,rfic1_bsispi";
		reg = <0x0 0x80202000 0x0 0x1000>;
	};

	rfic2_bsispi@80203000 {
		compatible = "mediatek,rfic2_bsispi";
		reg = <0x0 0x80203000 0x0 0x1000>;
	};

	mipi0_bsispi@80205000 {
		compatible = "mediatek,mipi0_bsispi";
		reg = <0x0 0x80205000 0x0 0x1000>;
	};

	mipi1_bsispi@80206000 {
		compatible = "mediatek,mipi1_bsispi";
		reg = <0x0 0x80206000 0x0 0x1000>;
	};

	idc_suart@80207000 {
		compatible = "mediatek,idc_suart";
		reg = <0x0 0x80207000 0x0 0x1000>;
	};

	mdm_psys_misc@8020d000 {
		compatible = "mediatek,mdm_psys_misc";
		reg = <0x0 0x8020d000 0x0 0x1000>;
	};

	mdm_psys_mbistcon@8020e000 {
		compatible = "mediatek,mdm_psys_mbistcon";
		reg = <0x0 0x8020e000 0x0 0x1000>;
	};

	md1_abb_mixedsys@8020c000 {
		compatible = "mediatek,md1_abb_mixedsys";
		reg = <0x0 0x8020c000 0x0 0x1000>;
	};

	md2_abb_mixedsys@8020c000 {
		compatible = "mediatek,md2_abb_mixedsys";
		reg = <0x0 0x8020c000 0x0 0x1000>;
	};

	idma@82000000 {
		compatible = "mediatek,idma";
		reg = <0x0 0x82000000 0x0 0x1000>;
	};

	ahb2dspio@82800000 {
		compatible = "mediatek,ahb2dspio";
		reg = <0x0 0x82800000 0x0 0x1000>;
	};

	md2g_confg@82c00000 {
		compatible = "mediatek,md2g_confg";
		reg = <0x0 0x82c00000 0x0 0x1000>;
	};

	apc@82c30000 {
		compatible = "mediatek,apc";
		reg = <0x0 0x82c30000 0x0 0x1000>;
	};

	csd_acc@82c70000 {
		compatible = "mediatek,csd_acc";
		reg = <0x0 0x82c70000 0x0 0x1000>;
	};

	share_d1@82ca0000 {
		compatible = "mediatek,share_d1";
		reg = <0x0 0x82ca0000 0x0 0x1000>;
	};

	irdma@82cb0000 {
		compatible = "mediatek,irdma";
		reg = <0x0 0x82cb0000 0x0 0x1000>;
	};

	patch@82cc0000 {
		compatible = "mediatek,patch";
		reg = <0x0 0x82cc0000 0x0 0x1000>;
	};

	mdafe@82cd0000 {
		compatible = "mediatek,mdafe";
		reg = <0x0 0x82cd0000 0x0 0x1000>;
	};

	bfe@82ce0000 {
		compatible = "mediatek,bfe";
		reg = <0x0 0x82ce0000 0x0 0x1000>;
	};

	modem_lite_confg@83000000 {
		compatible = "mediatek,modem_lite_confg";
		reg = <0x0 0x83000000 0x0 0x1000>;
	};

	modem_lite_topsm@83010000 {
		compatible = "mediatek,modem_lite_topsm";
		reg = <0x0 0x83010000 0x0 0x1000>;
	};

	tdma@83020000 {
		compatible = "mediatek,tdma";
		reg = <0x0 0x83020000 0x0 0x1000>;
	};

	shreg2@83030000 {
		compatible = "mediatek,shreg2";
		reg = <0x0 0x83030000 0x0 0x1000>;
	};

	divider@83040000 {
		compatible = "mediatek,divider";
		reg = <0x0 0x83040000 0x0 0x1000>;
	};

	fcs@83050000 {
		compatible = "mediatek,fcs";
		reg = <0x0 0x83050000 0x0 0x1000>;
	};

	gcu@83060000 {
		compatible = "mediatek,gcu";
		reg = <0x0 0x83060000 0x0 0x1000>;
	};

	bsi_2g@83070000 {
		compatible = "mediatek,bsi_2g";
		reg = <0x0 0x83070000 0x0 0x1000>;
	};

	bpi_2g@83080000 {
		compatible = "mediatek,bpi_2g";
		reg = <0x0 0x83080000 0x0 0x1000>;
	};

	afc_2g@83090000 {
		compatible = "mediatek,afc_2g";
		reg = <0x0 0x83090000 0x0 0x1000>;
	};

	tdd@84000000 {
		compatible = "mediatek,tdd";
		reg = <0x0 0x84000000 0x0 0x1000>;
	};

	l2ulsbdma@85000000 {
		compatible = "mediatek,l2ulsbdma";
		reg = <0x0 0x85000000 0x0 0x1000>;
	};

	l2ulhbdma@85010000 {
		compatible = "mediatek,l2ulhbdma";
		reg = <0x0 0x85010000 0x0 0x1000>;
	};

	l2dlsbdma@85020000 {
		compatible = "mediatek,l2dlsbdma";
		reg = <0x0 0x85020000 0x0 0x1000>;
	};

	l2dlhbdma@85030000 {
		compatible = "mediatek,l2dlhbdma";
		reg = <0x0 0x85030000 0x0 0x1000>;
	};

	l2mbist@85040000 {
		compatible = "mediatek,l2mbist";
		reg = <0x0 0x85040000 0x0 0x1000>;
	};

	l2pseuphy@85050000 {
		compatible = "mediatek,l2pseuphy";
		reg = <0x0 0x85050000 0x0 0x1000>;
	};

	l2hwlog@85058000 {
		compatible = "mediatek,l2hwlog";
		reg = <0x0 0x85058000 0x0 0x1000>;
	};

	l2soindma@85060000 {
		compatible = "mediatek,l2soindma";
		reg = <0x0 0x85060000 0x0 0x1000>;
	};

	l2sooutdma@85070000 {
		compatible = "mediatek,l2sooutdma";
		reg = <0x0 0x85070000 0x0 0x1000>;
	};

	l2ullmac@85080000 {
		compatible = "mediatek,l2ullmac";
		reg = <0x0 0x85080000 0x0 0x1000>;
	};

	l2dllmac@85090000 {
		compatible = "mediatek,l2dllmac";
		reg = <0x0 0x85090000 0x0 0x1000>;
	};

	l2calmac@85098000 {
		compatible = "mediatek,l2calmac";
		reg = <0x0 0x85098000 0x0 0x1000>;
	};

	l2ulfifomng@850a0000 {
		compatible = "mediatek,l2ulfifomng";
		reg = <0x0 0x850a0000 0x0 0x1000>;
	};

	l2dlfifomng@850a4000 {
		compatible = "mediatek,l2dlfifomng";
		reg = <0x0 0x850a4000 0x0 0x1000>;
	};

	l2sofifomng@850a8000 {
		compatible = "mediatek,l2sofifomng";
		reg = <0x0 0x850a8000 0x0 0x1000>;
	};

	l2sec@850b0000 {
		compatible = "mediatek,l2sec";
		reg = <0x0 0x850b0000 0x0 0x1000>;
	};

	l2ulsecctl@850b4000 {
		compatible = "mediatek,l2ulsecctl";
		reg = <0x0 0x850b4000 0x0 0x1000>;
	};

	l2dlsecctl@850b8000 {
		compatible = "mediatek,l2dlsecctl";
		reg = <0x0 0x850b8000 0x0 0x1000>;
	};

	l2sosecctl@850bc000 {
		compatible = "mediatek,l2sosecctl";
		reg = <0x0 0x850bc000 0x0 0x1000>;
	};

	l2misc@850c0000 {
		compatible = "mediatek,l2misc";
		reg = <0x0 0x850c0000 0x0 0x1000>;
	};

	l2ulbuf@850e0000 {
		compatible = "mediatek,l2ulbuf";
		reg = <0x0 0x850e0000 0x0 0x1000>;
	};

	l2dlbuf@850f0000 {
		compatible = "mediatek,l2dlbuf";
		reg = <0x0 0x850f0000 0x0 0x1000>;
	};

	mdl1ao@f60f0000 {
		compatible = "mediatek,mdl1ao";
		reg = <0x0 0xf60f0000 0x0 0x1000>;
	};

	modem_confg@87000000 {
		compatible = "mediatek,modem_confg";
		reg = <0x0 0x87000000 0x0 0x1000>;
	};

	modem_topsm@87010000 {
		compatible = "mediatek,modem_topsm";
		reg = <0x0 0x87010000 0x0 0x1000>;
	};

	bsi_3g@87070000 {
		compatible = "mediatek,bsi_3g";
		reg = <0x0 0x87070000 0x0 0x1000>;
	};

	bpi_3g@87080000 {
		compatible = "mediatek,bpi_3g";
		reg = <0x0 0x87080000 0x0 0x1000>;
	};

	afc_3g@87090000 {
		compatible = "mediatek,afc_3g";
		reg = <0x0 0x87090000 0x0 0x1000>;
	};

	wcdma_timer@870a0000 {
		compatible = "mediatek,wcdma_timer";
		reg = <0x0 0x870a0000 0x0 0x1000>;
	};

	dpa_bc@870b0000 {
		compatible = "mediatek,dpa_bc";
		reg = <0x0 0x870b0000 0x0 0x1000>;
	};

	pfc_encode@870c0000 {
		compatible = "mediatek,pfc_encode";
		reg = <0x0 0x870c0000 0x0 0x1000>;
	};

	pfc_decode@870d0000 {
		compatible = "mediatek,pfc_decode";
		reg = <0x0 0x870d0000 0x0 0x1000>;
	};

	hspasys_1_confg@87200000 {
		compatible = "mediatek,hspasys_1_confg";
		reg = <0x0 0x87200000 0x0 0x1000>;
	};

	hseq@87210000 {
		compatible = "mediatek,hseq";
		reg = <0x0 0x87210000 0x0 0x1000>;
	};

	hsce@87220000 {
		compatible = "mediatek,hsce";
		reg = <0x0 0x87220000 0x0 0x1000>;
	};

	hspasys_1_mbist@87230000 {
		compatible = "mediatek,hspasys_1_mbist";
		reg = <0x0 0x87230000 0x0 0x1000>;
	};

	hspasys_2_confg@87400000 {
		compatible = "mediatek,hspasys_2_confg";
		reg = <0x0 0x87400000 0x0 0x1000>;
	};

	hseq_dc@87410000 {
		compatible = "mediatek,hseq_dc";
		reg = <0x0 0x87410000 0x0 0x1000>;
	};

	hsce_dc@87420000 {
		compatible = "mediatek,hsce_dc";
		reg = <0x0 0x87420000 0x0 0x1000>;
	};

	rake_dc@87430000 {
		compatible = "mediatek,rake_dc";
		reg = <0x0 0x87430000 0x0 0x1000>;
	};

	hspasys_2_mbist@87440000 {
		compatible = "mediatek,hspasys_2_mbist";
		reg = <0x0 0x87440000 0x0 0x1000>;
	};

	uea_uia_u0@87600000 {
		compatible = "mediatek,uea_uia_u0";
		reg = <0x0 0x87600000 0x0 0x1000>;
	};

	uea_uia_u1@87610000 {
		compatible = "mediatek,uea_uia_u1";
		reg = <0x0 0x87610000 0x0 0x1000>;
	};

	dpa_rlc@87620000 {
		compatible = "mediatek,dpa_rlc";
		reg = <0x0 0x87620000 0x0 0x1000>;
	};

	dpa_mac@87630000 {
		compatible = "mediatek,dpa_mac";
		reg = <0x0 0x87630000 0x0 0x1000>;
	};

	upa@f0920000 {
		compatible = "mediatek,upa";
		reg = <0x0 0xf0920000 0x0 0x1000>;
	};

	h_rxbrp@87650000 {
		compatible = "mediatek,h_rxbrp";
		reg = <0x0 0x87650000 0x0 0x1000>;
	};

	rxbrp@87660000 {
		compatible = "mediatek,rxbrp";
		reg = <0x0 0x87660000 0x0 0x1000>;
	};

	hspasys_3_confg@f0910000 {
		compatible = "mediatek,hspasys_3_confg";
		reg = <0x0 0xf0910000 0x0 0x1000>;
	};

	txbrp@87680000 {
		compatible = "mediatek,txbrp";
		reg = <0x0 0x87680000 0x0 0x1000>;
	};

	txcrp@87690000 {
		compatible = "mediatek,txcrp";
		reg = <0x0 0x87690000 0x0 0x1000>;
	};

	h_txbrp@876a0000 {
		compatible = "mediatek,h_txbrp";
		reg = <0x0 0x876a0000 0x0 0x1000>;
	};

	txupc@876b0000 {
		compatible = "mediatek,txupc";
		reg = <0x0 0x876b0000 0x0 0x1000>;
	};

	bc@876c0000 {
		compatible = "mediatek,bc";
		reg = <0x0 0x876c0000 0x0 0x1000>;
	};

	dbg_tx@876d0000 {
		compatible = "mediatek,dbg_tx";
		reg = <0x0 0x876d0000 0x0 0x1000>;
	};

	hspasys_3_mbist@876e0000 {
		compatible = "mediatek,hspasys_3_mbist";
		reg = <0x0 0x876e0000 0x0 0x1000>;
	};

	rxsrp@87800000 {
		compatible = "mediatek,rxsrp";
		reg = <0x0 0x87800000 0x0 0x1000>;
	};

	indec@87810000 {
		compatible = "mediatek,indec";
		reg = <0x0 0x87810000 0x0 0x1000>;
	};

	rake_0@87820000 {
		compatible = "mediatek,rake_0";
		reg = <0x0 0x87820000 0x0 0x1000>;
	};

	rake_1@87830000 {
		compatible = "mediatek,rake_1";
		reg = <0x0 0x87830000 0x0 0x1000>;
	};

	rake_2@87840000 {
		compatible = "mediatek,rake_2";
		reg = <0x0 0x87840000 0x0 0x1000>;
	};

	searcher@87850000 {
		compatible = "mediatek,searcher";
		reg = <0x0 0x87850000 0x0 0x1000>;
	};

	rxdfe@87860000 {
		compatible = "mediatek,rxdfe";
		reg = <0x0 0x87860000 0x0 0x1000>;
	};

	hspasys_4_confg@87870000 {
		compatible = "mediatek,hspasys_4_confg";
		reg = <0x0 0x87870000 0x0 0x1000>;
	};

	dbg@87880000 {
		compatible = "mediatek,dbg";
		reg = <0x0 0x87880000 0x0 0x1000>;
	};

	dwrap0@87890000 {
		compatible = "mediatek,dwrap0";
		reg = <0x0 0x87890000 0x0 0x1000>;
	};

	log3g@878a0000 {
		compatible = "mediatek,log3g";
		reg = <0x0 0x878a0000 0x0 0x1000>;
	};

	hspasys_4_mbist@878b0000 {
		compatible = "mediatek,hspasys_4_mbist";
		reg = <0x0 0x878b0000 0x0 0x1000>;
	};

	dwrap1@878c0000 {
		compatible = "mediatek,dwrap1";
		reg = <0x0 0x878c0000 0x0 0x1000>;
	};

	c2ksys@38000000 {
		compatible = "mediatek,c2ksys";
		reg = <0x0 0x38000000 0x0 0x1000>;
	};

	usbphy {
		compatible = "usb-nop-xceiv";
		linux,phandle = <0x87>;
		phandle = <0x87>;
	};

	usb3_phy {
		compatible = "mediatek,usb3_phy";
		clocks = <0x15 0x5b 0x15 0x3e>;
		clock-names = "ssusb_clk", "sys_ck";
	};

	mt_soc_btcvsd_rx_pcm {
		compatible = "mediatek,mt_soc_btcvsd_rx_pcm";
	};

	mt_soc_btcvsd_tx_pcm {
		compatible = "mediatek,mt_soc_btcvsd_tx_pcm";
	};

	mt_soc_deep_buffer_dl_pcm {
		compatible = "mediatek,mt_soc_pcm_deep_buffer_dl";
	};

	mt_soc_ul1_pcm {
		compatible = "mediatek,mt_soc_pcm_capture";
	};

	mt_soc_voice_md1 {
		compatible = "mediatek,mt_soc_pcm_voice_md1";
	};

	mt_soc_hdmi_pcm {
		compatible = "mediatek,mt_soc_pcm_hdmi";
	};

	mt_soc_uldlloopback_pcm {
		compatible = "mediatek,mt_soc_pcm_uldlloopback";
	};

	mt_soc_i2s0_pcm {
		compatible = "mediatek,mt_soc_pcm_dl1_i2s0";
	};

	mt_soc_mrgrx_pcm {
		compatible = "mediatek,mt_soc_pcm_mrgrx";
	};

	mt_soc_mrgrx_awb_pcm {
		compatible = "mediatek,mt_soc_pcm_mrgrx_awb";
	};

	mt_soc_fm_i2s_pcm {
		compatible = "mediatek,mt_soc_pcm_fm_i2s";
	};

	mt_soc_fm_i2s_awb_pcm {
		compatible = "mediatek,mt_soc_pcm_fm_i2s_awb";
	};

	mt_soc_i2s0dl1_pcm {
		compatible = "mediatek,mt_soc_pcm_dl1_i2s0dl1";
	};

	mt_soc_dl1_awb_pcm {
		compatible = "mediatek,mt_soc_pcm_dl1_awb";
	};

	mt_soc_voice_md1_bt {
		compatible = "mediatek,mt_soc_pcm_voice_md1_bt";
	};

	mt_soc_voip_bt_out {
		compatible = "mediatek,mt_soc_pcm_dl1_bt";
	};

	mt_soc_voip_bt_in {
		compatible = "mediatek,mt_soc_pcm_bt_dai";
	};

	mt_soc_tdmrx_pcm {
		compatible = "mediatek,mt_soc_tdm_capture";
	};

	mt_soc_fm_mrgtx_pcm {
		compatible = "mediatek,mt_soc_pcm_fmtx";
	};

	mt_soc_ul2_pcm {
		compatible = "mediatek,mt_soc_pcm_capture2";
	};

	mt_soc_i2s0_awb_pcm {
		compatible = "mediatek,mt_soc_pcm_i2s0_awb";
	};

	mt_soc_voice_md2 {
		compatible = "mediatek,mt_soc_pcm_voice_md2";
	};

	mt_soc_pcm_dl1_scp_spk {
		compatible = "mediatek,mt_soc_pcm_dl1_scp_spk";
	};

	mt_soc_pcm_voice_scp {
		compatible = "mediatek,mt_soc_pcm_voice_scp";
	};

	mt_soc_routing_pcm {
		compatible = "mediatek,mt_soc_pcm_routing";
	};

	mt_soc_voice_md2_bt {
		compatible = "mediatek,mt_soc_pcm_voice_md2_bt";
	};

	mt_soc_hp_impedance_pcm {
		compatible = "mediatek,mt_soc_pcm_hp_impedance";
	};

	mt_soc_codec_name {
		compatible = "mediatek,mt_soc_codec_63xx";
		use_hp_depop_flow = <0x0>;
		use_ul_260k = <0x0>;
		pcbinfo = <0x1b 0xaf 0x0 0x1b 0x6f 0x0>;
	};

	mt_soc_dummy_pcm {
		compatible = "mediatek,mt_soc_pcm_dummy";
	};

	mt_soc_codec_dummy_name {
		compatible = "mediatek,mt_soc_codec_dummy";
	};

	mt_soc_routing_dai_name {
		compatible = "mediatek,mt_soc_dai_routing";
	};

	mt_soc_dai_name {
		compatible = "mediatek,mt_soc_dai_stub";
	};

	mt_soc_dl2_pcm {
		compatible = "mediatek,mt_soc_pcm_dl2";
	};

	mt_soc_anc_pcm {
		compatible = "mediatek,mt_soc_pcm_anc";
	};

	mt_soc_pcm_voice_ultra {
		compatible = "mediatek,mt_soc_pcm_voice_ultra";
	};

	mt_soc_pcm_voice_usb {
		compatible = "mediatek,mt_soc_pcm_voice_usb";
	};

	mt_soc_pcm_voice_usb_echoref {
		compatible = "mediatek,mt_soc_pcm_voice_usb_echoref";
	};

	mt_soc_vow_barge_in_pcm {
		compatible = "mediatek,mt_soc_pcm_vow_barge_in";
	};

	firmware {

		android {
			compatible = "android,firmware";

			fstab {
				compatible = "android,fstab";

				vendor {
					compatible = "android,vendor";
					dev = "/dev/block/platform/bootdevice/by-name/vendor";
					type = "ext4";
					mnt_flags = "ro";
					fsmgr_flags = "wait";
				};
			};
		};
	};

	odm {
		compatible = "simple-bus";
		linux,phandle = <0x88>;
		phandle = <0x88>;
	};

	radio_md_cfg {
		compatible = "mediatek,radio_md_cfg";
		linux,phandle = <0x89>;
		phandle = <0x89>;
	};

	dynamic_options {
		compatible = "mediatek,dynamic_options";
		linux,phandle = <0x8a>;
		phandle = <0x8a>;
	};

	mt_charger {
		compatible = "mediatek,mt-charger";
		linux,phandle = <0x8b>;
		phandle = <0x8b>;
	};

	lk_charger {
		compatible = "mediatek,lk_charger";
		enable_pe_plus;
		power_path_support;
		max_charger_voltage = <0x632ea0>;
		fast_charge_voltage = <0x2dc6c0>;
		usb_charger_current = <0x7a120>;
		ac_charger_current = <0x1f47d0>;
		ac_charger_input_current = <0x30d400>;
		non_std_ac_charger_current = <0x7a120>;
		charging_host_charger_current = <0x16e360>;
		ta_ac_charger_current = <0x2dc6c0>;
		pd_charger_current = <0x7a120>;
		temp_t4_threshold = <0x32>;
		temp_t3_threshold = <0x2d>;
		temp_t1_threshold = <0x0>;
		linux,phandle = <0x8c>;
		phandle = <0x8c>;
	};

	charger {
		compatible = "mediatek,charger";
		algorithm_name = "SwitchCharging";
		enable_pe_plus;
		enable_pe_2;
		enable_pe_3;
		enable_pe_4;
		enable_type_c;
		power_path_support;
		battery_cv = <0x426030>;
		max_charger_voltage = <0x632ea0>;
		min_charger_voltage = <0x4630c0>;
		usb_charger_current_suspend = <0x0>;
		usb_charger_current_unconfigured = <0x11170>;
		usb_charger_current_configured = <0x7a120>;
		usb_charger_current = <0x7a120>;
		ac_charger_current = <0x1f47d0>;
		ac_charger_input_current = <0x30d400>;
		non_std_ac_charger_current = <0x7a120>;
		charging_host_charger_current = <0x16e360>;
		apple_1_0a_charger_current = <0x9eb10>;
		apple_2_1a_charger_current = <0xc3500>;
		ta_ac_charger_current = <0x2dc6c0>;
		jeita_temp_above_t4_cv_voltage = <0x40b280>;
		jeita_temp_t3_to_t4_cv_voltage = <0x40b280>;
		jeita_temp_t2_to_t3_cv_voltage = <0x423920>;
		jeita_temp_t1_to_t2_cv_voltage = <0x40b280>;
		jeita_temp_t0_to_t1_cv_voltage = <0x3da540>;
		jeita_temp_below_t0_cv_voltage = <0x3da540>;
		temp_t4_threshold = <0x32>;
		temp_t4_thres_minus_x_degree = <0x2f>;
		temp_t3_threshold = <0x2d>;
		temp_t3_thres_minus_x_degree = <0x27>;
		temp_t2_threshold = <0xa>;
		temp_t2_thres_plus_x_degree = <0x10>;
		temp_t1_threshold = <0x0>;
		temp_t1_thres_plus_x_degree = <0x6>;
		temp_t0_threshold = <0x0>;
		temp_t0_thres_plus_x_degree = <0x0>;
		temp_neg_10_threshold = <0x0>;
		enable_min_charge_temperature;
		min_charge_temperature = <0x0>;
		min_charge_temperature_plus_x_degree = <0x6>;
		max_charge_temperature = <0x32>;
		max_charge_temperature_minus_x_degree = <0x2f>;
		pe20_ichg_level_threshold = <0x3e8>;
		ta_start_battery_soc = <0x0>;
		ta_stop_battery_soc = <0x55>;
		pe40_single_charger_input_current = <0x2dc6c0>;
		pe40_single_charger_current = <0x2dc6c0>;
		pe40_dual_charger_input_current = <0x2dc6c0>;
		pe40_dual_charger_chg1_current = <0x1e8480>;
		pe40_dual_charger_chg2_current = <0x1e8480>;
		pe40_stop_battery_soc = <0x50>;
		chg1_ta_ac_charger_current = <0x16e360>;
		chg2_ta_ac_charger_current = <0x16e360>;
		cable_imp_threshold = <0x2bb>;
		vbat_cable_imp_threshold = <0xf3c>;
		bif_threshold1 = <0x40d990>;
		bif_threshold2 = <0x419ce0>;
		bif_cv_under_threshold2 = <0x43e6d0>;
		linux,phandle = <0x8d>;
		phandle = <0x8d>;
	};

	rt9465_slave_chr {
		compatible = "richtek,rt9465";
		linux,phandle = <0x8e>;
		phandle = <0x8e>;
	};

	rt-pd-manager {
		compatible = "mediatek,rt-pd-manager";
	};

	battery-dts_vivo {
		compatible = "mediatek,battery-dts_vivo";
	};

	bat_metter {
		compatible = "mediatek,bat_meter";
		linux,phandle = <0x8f>;
		phandle = <0x8f>;
	};

	battery-id-dts {
		compatible = "vivo,battery_id_dts";
	};

	battery_id {
		compatible = "vivo,battery_id";
		linux,phandle = <0x90>;
		phandle = <0x90>;
	};

	power_control {
		compatible = "vivo,power_control";
		linux,phandle = <0x91>;
		phandle = <0x91>;
	};

	fuelsummary {
		compatible = "vivo,fuelsummary";
		linux,phandle = <0x92>;
		phandle = <0x92>;
	};

	mt6370_pmu_eint {
		linux,phandle = <0x93>;
		phandle = <0x93>;
	};

	fingerprint {
		compatible = "mediatek,goodix-fp";
		vfp-supply = <0x51>;
		fpc,enable-wakeup;
		linux,phandle = <0x94>;
		phandle = <0x94>;
	};

	fpsensor_fp_eint {
		compatible = "mediatek,fpsensor_fp_eint";
		int-gpios = <0x1b 0x5 0x0>;
		linux,phandle = <0x95>;
		phandle = <0x95>;
	};

	fp_id_detect {
		compatible = "fp-id";
		linux,phandle = <0x96>;
		phandle = <0x96>;
	};

	mt6370_pd_eint {
		linux,phandle = <0x97>;
		phandle = <0x97>;
	};

	scp_dvfs {
		compatible = "mediatek,scp_dvfs";
		clocks = <0x42 0xf 0x40 0x42 0x42 0x42 0x2e 0x42 0x30 0x42 0x40 0x42 0x2d 0x42 0x3d>;
		clock-names = "clk_mux", "clk_pll_0", "clk_pll_1", "clk_pll_2", "clk_pll_3", "clk_pll_4", "clk_pll_5", "clk_pll_6";
	};

	rt5081_pmu_eint {
		linux,phandle = <0x98>;
		phandle = <0x98>;
	};

	rt5081_pd_eint {
		linux,phandle = <0x99>;
		phandle = <0x99>;
	};

	pmic_clock_buffer_ctrl {
		compatible = "mediatek,pmic_clock_buffer";
		mediatek,clkbuf-quantity = <0x7>;
		mediatek,clkbuf-config = <0x2 0x1 0x1 0x2 0x0 0x0 0x1>;
		mediatek,clkbuf-driving-current = <0x1 0x1 0x1 0x1 0x1 0x1 0x1>;
		linux,phandle = <0x9a>;
		phandle = <0x9a>;
	};

	msdc1_ins {
		linux,phandle = <0x9b>;
		phandle = <0x9b>;
	};

	gyro {
		linux,phandle = <0x9c>;
		phandle = <0x9c>;
	};

	mse {
		linux,phandle = <0x9d>;
		phandle = <0x9d>;
	};

	als {
		linux,phandle = <0x9e>;
		phandle = <0x9e>;
	};

	nfc {
		compatible = "mediatek,nfc-gpio-v2";
		gpio-rst = <0x13>;
		gpio-rst-std = <0x1b 0x13 0x0>;
		gpio-irq = <0x14>;
		gpio-irq-std = <0x1b 0x14 0x0>;
		linux,phandle = <0x9f>;
		phandle = <0x9f>;
	};

	irq_nfc {
		compatible = "mediatek,irq_nfc-eint";
		linux,phandle = <0xa0>;
		phandle = <0xa0>;
	};

	smart_pa {
		linux,phandle = <0xa1>;
		phandle = <0xa1>;
	};

	md1_sim1_hot_plug_eint {
		linux,phandle = <0xa2>;
		phandle = <0xa2>;
	};

	md1_sim2_hot_plug_eint {
		linux,phandle = <0xa3>;
		phandle = <0xa3>;
	};

	usb_c_pinctrl {
		linux,phandle = <0xa4>;
		phandle = <0xa4>;
	};

	ssusb_ip_sleep {
		compatible = "mediatek,usb_ipsleep";
		interrupt-parent = <0x1b>;
		interrupts = <0xb3 0x8 0xbb 0x0>;
		status = "okay";
		linux,phandle = <0xa5>;
		phandle = <0xa5>;
	};

	touchscreencfg {
		status = "disabled";
		linux,phandle = <0xa6>;
		phandle = <0xa6>;
	};

	sar_power_device {
		compatible = "sar-power";
		linux,phandle = <0xa7>;
		phandle = <0xa7>;
	};

	alsps_hub_device {
		compatible = "alsps_hub_pl";
		linux,phandle = <0xa8>;
		phandle = <0xa8>;
	};

	vivo_vib8846 {
		compatible = "vivo,vib_8846";
		linux,phandle = <0xa9>;
		phandle = <0xa9>;
	};

	eas {
		eff_turn_point = <0x1e2>;
	};

	vivo_board_info {
		compatible = "vivo,vendor_board_info";
		linux,phandle = <0xaa>;
		phandle = <0xaa>;
	};

	mt_pmic_regulator {
		compatible = "mediatek,mt_pmic";

		buck_regulators {
			compatible = "mediatek,mt_pmic_buck_regulators";

			buck_vdram1 {
				regulator-name = "vdram1";
				regulator-min-microvolt = <0x7a120>;
				regulator-max-microvolt = <0x1fda4c>;
				regulator-ramp-delay = <0x30d4>;
				regulator-enable-ramp-delay = <0x0>;
				linux,phandle = <0xab>;
				phandle = <0xab>;
			};

			buck_vcore {
				regulator-name = "vcore";
				regulator-min-microvolt = <0x7a120>;
				regulator-max-microvolt = <0x13bdb6>;
				regulator-ramp-delay = <0x186a>;
				regulator-enable-ramp-delay = <0xc8>;
				linux,phandle = <0xac>;
				phandle = <0xac>;
			};

			buck_vpa {
				regulator-name = "vpa";
				regulator-min-microvolt = <0x7a120>;
				regulator-max-microvolt = <0x37b1d0>;
				regulator-ramp-delay = <0xc350>;
				regulator-enable-ramp-delay = <0xfa>;
				linux,phandle = <0xad>;
				phandle = <0xad>;
			};

			buck_vproc11 {
				regulator-name = "vproc11";
				regulator-min-microvolt = <0x7a120>;
				regulator-max-microvolt = <0x13bdb6>;
				regulator-ramp-delay = <0x186a>;
				regulator-enable-ramp-delay = <0xc8>;
				linux,phandle = <0xae>;
				phandle = <0xae>;
			};

			buck_vproc12 {
				regulator-name = "vproc12";
				regulator-min-microvolt = <0x7a120>;
				regulator-max-microvolt = <0x13bdb6>;
				regulator-ramp-delay = <0x186a>;
				regulator-enable-ramp-delay = <0xc8>;
				linux,phandle = <0xaf>;
				phandle = <0xaf>;
			};

			buck_vgpu {
				regulator-name = "vgpu";
				regulator-min-microvolt = <0x7a120>;
				regulator-max-microvolt = <0x13bdb6>;
				regulator-ramp-delay = <0x186a>;
				regulator-enable-ramp-delay = <0xc8>;
				linux,phandle = <0xb0>;
				phandle = <0xb0>;
			};

			buck_vs2 {
				regulator-name = "vs2";
				regulator-min-microvolt = <0x7a120>;
				regulator-max-microvolt = <0x1fda4c>;
				regulator-ramp-delay = <0x30d4>;
				regulator-enable-ramp-delay = <0x0>;
				linux,phandle = <0xb1>;
				phandle = <0xb1>;
			};

			buck_vmodem {
				regulator-name = "vmodem";
				regulator-min-microvolt = <0x7a120>;
				regulator-max-microvolt = <0x13bdb6>;
				regulator-ramp-delay = <0x186a>;
				regulator-enable-ramp-delay = <0x384>;
				linux,phandle = <0xb2>;
				phandle = <0xb2>;
			};

			buck_vs1 {
				regulator-name = "vs1";
				regulator-min-microvolt = <0xf4240>;
				regulator-max-microvolt = <0x277b6c>;
				regulator-ramp-delay = <0x30d4>;
				regulator-enable-ramp-delay = <0x0>;
				linux,phandle = <0xb3>;
				phandle = <0xb3>;
			};
		};

		ldo_regulators {
			compatible = "mediatek,mt_pmic_ldo_regulators";

			ldo_vdram2 {
				regulator-name = "vdram2";
				regulator-min-microvolt = <0x927c0>;
				regulator-max-microvolt = <0x1b7740>;
				regulator-enable-ramp-delay = <0xce4>;
				linux,phandle = <0xb4>;
				phandle = <0xb4>;
			};

			ldo_vsim1 {
				regulator-name = "vsim1";
				regulator-min-microvolt = <0x19f0a0>;
				regulator-max-microvolt = <0x2f4d60>;
				regulator-enable-ramp-delay = <0x21c>;
				linux,phandle = <0xb5>;
				phandle = <0xb5>;
			};

			ldo_vibr {
				regulator-name = "vibr";
				regulator-min-microvolt = <0x124f80>;
				regulator-max-microvolt = <0x325aa0>;
				regulator-enable-ramp-delay = <0x3c>;
				linux,phandle = <0xb6>;
				phandle = <0xb6>;
			};

			ldo_vrf12 {
				compatible = "regulator-fixed";
				regulator-name = "vrf12";
				regulator-min-microvolt = <0x124f80>;
				regulator-max-microvolt = <0x124f80>;
				regulator-enable-ramp-delay = <0x78>;
				linux,phandle = <0xb7>;
				phandle = <0xb7>;
			};

			ldo_vio18 {
				compatible = "regulator-fixed";
				regulator-name = "vio18";
				regulator-min-microvolt = <0x1b7740>;
				regulator-max-microvolt = <0x1b7740>;
				regulator-enable-ramp-delay = <0xa8c>;
				linux,phandle = <0xb8>;
				phandle = <0xb8>;
			};

			ldo_vusb {
				regulator-name = "vusb";
				regulator-min-microvolt = <0x2dc6c0>;
				regulator-max-microvolt = <0x2f4d60>;
				regulator-enable-ramp-delay = <0x10e>;
				linux,phandle = <0xb9>;
				phandle = <0xb9>;
			};

			ldo_vcamio {
				compatible = "regulator-fixed";
				regulator-name = "vcamio";
				regulator-min-microvolt = <0x1b7740>;
				regulator-max-microvolt = <0x1b7740>;
				regulator-enable-ramp-delay = <0x10e>;
				linux,phandle = <0xba>;
				phandle = <0xba>;
			};

			ldo_vcamd {
				regulator-name = "vcamd";
				regulator-min-microvolt = <0xdbba0>;
				regulator-max-microvolt = <0x1b7740>;
				regulator-enable-ramp-delay = <0x10e>;
				linux,phandle = <0xbb>;
				phandle = <0xbb>;
			};

			ldo_vcn18 {
				compatible = "regulator-fixed";
				regulator-name = "vcn18";
				regulator-min-microvolt = <0x1b7740>;
				regulator-max-microvolt = <0x1b7740>;
				regulator-enable-ramp-delay = <0x10e>;
				linux,phandle = <0xbc>;
				phandle = <0xbc>;
			};

			ldo_vfe28 {
				compatible = "regulator-fixed";
				regulator-name = "vfe28";
				regulator-min-microvolt = <0x2ab980>;
				regulator-max-microvolt = <0x2ab980>;
				regulator-enable-ramp-delay = <0x10e>;
				linux,phandle = <0xbd>;
				phandle = <0xbd>;
			};

			ldo_vsram_proc11 {
				regulator-name = "vsram_proc11";
				regulator-min-microvolt = <0x7a120>;
				regulator-max-microvolt = <0x13bdb6>;
				regulator-ramp-delay = <0x186a>;
				regulator-enable-ramp-delay = <0xf0>;
				linux,phandle = <0xbe>;
				phandle = <0xbe>;
			};

			ldo_vcn28 {
				compatible = "regulator-fixed";
				regulator-name = "vcn28";
				regulator-min-microvolt = <0x2ab980>;
				regulator-max-microvolt = <0x2ab980>;
				regulator-enable-ramp-delay = <0x10e>;
				linux,phandle = <0xbf>;
				phandle = <0xbf>;
			};

			ldo_vsram_others {
				regulator-name = "vsram_others";
				regulator-min-microvolt = <0x7a120>;
				regulator-max-microvolt = <0x13bdb6>;
				regulator-ramp-delay = <0x186a>;
				regulator-enable-ramp-delay = <0xf0>;
				linux,phandle = <0xc0>;
				phandle = <0xc0>;
			};

			ldo_vsram_gpu {
				regulator-name = "vsram_gpu";
				regulator-min-microvolt = <0x7a120>;
				regulator-max-microvolt = <0x13bdb6>;
				regulator-ramp-delay = <0x186a>;
				regulator-enable-ramp-delay = <0xf0>;
				linux,phandle = <0xc1>;
				phandle = <0xc1>;
			};

			ldo_vxo22 {
				compatible = "regulator-fixed";
				regulator-name = "vxo22";
				regulator-min-microvolt = <0x2191c0>;
				regulator-max-microvolt = <0x2191c0>;
				regulator-enable-ramp-delay = <0x78>;
				linux,phandle = <0xc2>;
				phandle = <0xc2>;
			};

			ldo_vefuse {
				regulator-name = "vefuse";
				regulator-min-microvolt = <0x19f0a0>;
				regulator-max-microvolt = <0x1cfde0>;
				regulator-enable-ramp-delay = <0x10e>;
				linux,phandle = <0xc3>;
				phandle = <0xc3>;
			};

			ldo_vaux18 {
				compatible = "regulator-fixed";
				regulator-name = "vaux18";
				regulator-min-microvolt = <0x1b7740>;
				regulator-max-microvolt = <0x1b7740>;
				regulator-enable-ramp-delay = <0x10e>;
				linux,phandle = <0xc4>;
				phandle = <0xc4>;
			};

			ldo_vmch {
				regulator-name = "vmch";
				regulator-min-microvolt = <0x2c4020>;
				regulator-max-microvolt = <0x325aa0>;
				regulator-enable-ramp-delay = <0x3c>;
				linux,phandle = <0x1c>;
				phandle = <0x1c>;
			};

			ldo_vbif28 {
				compatible = "regulator-fixed";
				regulator-name = "vbif28";
				regulator-min-microvolt = <0x2ab980>;
				regulator-max-microvolt = <0x2ab980>;
				regulator-enable-ramp-delay = <0x10e>;
				linux,phandle = <0xc5>;
				phandle = <0xc5>;
			};

			ldo_vsram_proc12 {
				regulator-name = "vsram_proc12";
				regulator-min-microvolt = <0x7a120>;
				regulator-max-microvolt = <0x13bdb6>;
				regulator-ramp-delay = <0x186a>;
				regulator-enable-ramp-delay = <0xf0>;
				linux,phandle = <0xc6>;
				phandle = <0xc6>;
			};

			ldo_vcama1 {
				regulator-name = "vcama1";
				regulator-min-microvolt = <0x1b7740>;
				regulator-max-microvolt = <0x2dc6c0>;
				regulator-enable-ramp-delay = <0x10e>;
				linux,phandle = <0x51>;
				phandle = <0x51>;
			};

			ldo_vemc {
				regulator-name = "vemc";
				regulator-min-microvolt = <0x2c4020>;
				regulator-max-microvolt = <0x325aa0>;
				regulator-enable-ramp-delay = <0x3c>;
				linux,phandle = <0x14>;
				phandle = <0x14>;
			};

			ldo_vio28 {
				compatible = "regulator-fixed";
				regulator-name = "vio28";
				regulator-min-microvolt = <0x2ab980>;
				regulator-max-microvolt = <0x2ab980>;
				regulator-enable-ramp-delay = <0x10e>;
				linux,phandle = <0xc7>;
				phandle = <0xc7>;
			};

			ldo_va12 {
				compatible = "regulator-fixed";
				regulator-name = "va12";
				regulator-min-microvolt = <0x124f80>;
				regulator-max-microvolt = <0x124f80>;
				regulator-enable-ramp-delay = <0x10e>;
				linux,phandle = <0xc8>;
				phandle = <0xc8>;
			};

			ldo_vrf18 {
				compatible = "regulator-fixed";
				regulator-name = "vrf18";
				regulator-min-microvolt = <0x1b7740>;
				regulator-max-microvolt = <0x1b7740>;
				regulator-enable-ramp-delay = <0x78>;
				linux,phandle = <0xc9>;
				phandle = <0xc9>;
			};

			ldo_vcn33_bt {
				regulator-name = "vcn33_bt";
				regulator-min-microvolt = <0x325aa0>;
				regulator-max-microvolt = <0x3567e0>;
				regulator-enable-ramp-delay = <0x10e>;
				linux,phandle = <0xca>;
				phandle = <0xca>;
			};

			ldo_vcn33_wifi {
				regulator-name = "vcn33_wifi";
				regulator-min-microvolt = <0x325aa0>;
				regulator-max-microvolt = <0x3567e0>;
				regulator-enable-ramp-delay = <0x10e>;
				linux,phandle = <0xcb>;
				phandle = <0xcb>;
			};

			ldo_vcama2 {
				regulator-name = "vcama2";
				regulator-min-microvolt = <0x1b7740>;
				regulator-max-microvolt = <0x2dc6c0>;
				regulator-enable-ramp-delay = <0x10e>;
				linux,phandle = <0xcc>;
				phandle = <0xcc>;
			};

			ldo_vmc {
				regulator-name = "vmc";
				regulator-min-microvolt = <0x1b7740>;
				regulator-max-microvolt = <0x325aa0>;
				regulator-enable-ramp-delay = <0x3c>;
				linux,phandle = <0x1d>;
				phandle = <0x1d>;
			};

			ldo_vldo28 {
				regulator-name = "vldo28";
				regulator-min-microvolt = <0x2ab980>;
				regulator-max-microvolt = <0x2dc6c0>;
				regulator-enable-ramp-delay = <0x10e>;
				linux,phandle = <0xcd>;
				phandle = <0xcd>;
			};

			ldo_vaud28 {
				compatible = "regulator-fixed";
				regulator-name = "vaud28";
				regulator-min-microvolt = <0x2ab980>;
				regulator-max-microvolt = <0x2ab980>;
				regulator-enable-ramp-delay = <0x10e>;
				linux,phandle = <0xce>;
				phandle = <0xce>;
			};

			ldo_vsim2 {
				regulator-name = "vsim2";
				regulator-min-microvolt = <0x19f0a0>;
				regulator-max-microvolt = <0x2f4d60>;
				regulator-enable-ramp-delay = <0x21c>;
				linux,phandle = <0xcf>;
				phandle = <0xcf>;
			};

			ldo_va09 {
				compatible = "regulator-fixed";
				regulator-name = "va09";
				regulator-min-microvolt = <0xdbba0>;
				regulator-max-microvolt = <0xdbba0>;
				regulator-enable-ramp-delay = <0x108>;
				regulator-boot-on;
				linux,phandle = <0xd0>;
				phandle = <0xd0>;
			};
		};
	};

	mt6370_pmu_dts {
		interrupt-controller;
		#interrupt-cells = <0x1>;
		mt6370,intr_gpio_num = <0x3>;
		mt6370,intr_gpio = <0x1b 0x3 0x0>;
		linux,phandle = <0xd1>;
		phandle = <0xd1>;

		core {
			compatible = "mediatek,mt6370_pmu_core";
			interrupt-names = "otp", "vdda_ovp", "vdda_uv";
			i2cstmr_rst_tmr = <0x0>;
			mrstb_en;
			mrstb_tmr = <0x3>;
			int_wdt = <0x0>;
			int_deg = <0x0>;
		};

		charger {
			compatible = "mediatek,mt6370_pmu_charger";
			interrupt-names = "chg_mivr", "chg_aiclmeasi", "attachi", "ovpctrl_uvp_d_evt", "chg_wdtmri", "chg_vbusov", "chg_tmri", "chg_treg";
			charger_name = "primary_chg";
			load_switch_name = "primary_load_switch";
			ichg = <0x1e8480>;
			aicr = <0x7a120>;
			mivr = <0x432380>;
			cv = <0x426030>;
			ieoc = <0x249f0>;
			safety_timer = <0xc>;
			dc_wdt = <0x3d0900>;
			ircmp_resistor = <0x61a8>;
			ircmp_vclamp = <0x7d00>;
			enable_te;
			enable_wdt;
		};

		mt6370_pmu_fled1 {
			compatible = "mediatek,mt6370_pmu_fled1";
			interrupt-names = "fled_lvf", "fled2_short", "fled1_short";
			fled_enable = <0x1>;
			torch_cur = <0x493e0>;
			strobe_cur = <0x124f80>;
			strobe_timeout = <0x960>;
		};

		mt6370_pmu_fled2 {
			compatible = "mediatek,mt6370_pmu_fled2";
			fled_enable = <0x1>;
			torch_cur = <0x30d40>;
			strobe_cur = <0xf4240>;
			strobe_timeout = <0x4b0>;
		};

		ldo {
			compatible = "mediatek,mt6370_pmu_ldo";
			interrupt-names = "ldo_oc";
			ldo_oms = <0x1>;
			ldo_vrc_lt = <0x1>;

			mt6370_ldo {
				regulator-name = "irtx_ldo";
				regulator-min-microvolt = <0x186a00>;
				regulator-max-microvolt = <0x3d0900>;
			};
		};

		rgbled {
			compatible = "mediatek,mt6370_pmu_rgbled";
			interrupt-names = "isink4_short", "isink3_short", "isink2_short", "isink1_short", "isink4_open", "isink3_open", "isink2_open", "isink1_open";
			mt,led_name = "mt6370_pmu_led1", "mt6370_pmu_led2", "mt6370_pmu_led3", "mt6370_pmu_led4";
			mt,led_default_trigger = "cc_mode", "cc_mode", "cc_mode", "none";
		};

		bled {
			compatible = "mediatek,mt6370_pmu_bled";
			interrupt-names = "bled_ocp";
			mt,bled_name = "mt6370_pmu_bled";
			mt,chan_en = <0xf>;
			mt,map_linear;
			mt,bl_ovp_level = <0x3>;
			mt,bl_ocp_level = <0x2>;
			mt,use_pwm;
			mt,pwm_fsample = <0x2>;
			mt,pwm_deglitch = <0x1>;
			mt,pwm_avg_cycle = <0x0>;
			mt,bled_ramptime = <0x3>;
			mt,bled_flash_ramp = <0x1>;
			mt,max_bled_brightness = <0x200>;
		};

		dsv {
			compatible = "mediatek,mt6370_pmu_dsv";
			interrupt-names = "dsv_vneg_ocp", "dsv_vpos_ocp", "dsv_bst_ocp", "dsv_vneg_scp", "dsv_vpos_scp";
			db_ext_en = <0x0>;
			db_periodic_fix = <0x0>;
			db_single_pin = <0x0>;
			db_freq_pm = <0x0>;
			db_periodic_mode = <0x0>;
			db_startup = <0x0>;
			db_vneg_20ms = <0x1>;
			db_vneg_disc = <0x0>;
			db_vpos_20ms = <0x1>;
			db_vpos_disc = <0x1>;
			db_delay = <0x3>;
			db_vbst = <0x1644>;
			db_vpos_slew = <0x1>;
			db_vneg_slew = <0x1>;

			mt6370_dsvp {
				regulator-name = "dsv_pos";
				regulator-min-microvolt = <0x3d0900>;
				regulator-max-microvolt = <0x5b8d80>;
			};

			mt6370_dsvn {
				regulator-name = "dsv_neg";
				regulator-min-microvolt = <0x3d0900>;
				regulator-max-microvolt = <0x5b8d80>;
			};
		};
	};

	type_c_port0 {
		tcpc-dual,supported_modes = <0x0>;
		mt-tcpc,name = "type_c_port0";
		mt-tcpc,role_def = <0x4>;
		mt-tcpc,rp_level = <0x0>;
		mt-tcpc,vconn_supply = <0x1>;
		mt-tcpc,notifier_supply_num = <0x3>;
		mt6370pd,intr_gpio = <0x1b 0x18 0x0>;
		mt6370pd,intr_gpio_num = <0x18>;
		linux,phandle = <0xd2>;
		phandle = <0xd2>;

		pd-data {
			pd,vid = <0x29cf>;
			pd,pid = <0x5081>;
			pd,source-cap-ext = <0x171129cf 0x0 0x102 0x0 0x0 0x2000000>;
			pd,mfrs = "RichtekTCPC";
			pd,charging_policy = <0x21>;
			pd,source-pdo-size = <0x1>;
			pd,source-pdo-data = <0x19032>;
			pd,sink-pdo-size = <0x2>;
			pd,sink-pdo-data = <0x190c8 0xc0761e3c>;
			pd,id-vdo-size = <0x3>;
			pd,id-vdo-data = <0xd10029cf 0x0 0x10000>;
			bat,nr = <0x1>;
			pd,country_nr = <0x0>;

			bat-info0 {
				bat,vid = <0x29cf>;
				bat,pid = <0x1711>;
				bat,mfrs = "bat1";
				bat,design_cap = <0xbb8>;
			};
		};

		dpm_caps {
			local_dr_power;
			local_dr_data;
			local_usb_comm;
			local_no_suspend;
			local_vconn_supply;
			attemp_enter_dp_mode;
			attemp_discover_cable;
			attemp_discover_id;
			pr_check = <0x0>;
			pr_check_gp_source;
			dr_check = <0x0>;
		};
	};

	__symbols__ {
		chosen = "/chosen";
		cpu0 = "/cpus/cpu@000";
		cpu1 = "/cpus/cpu@001";
		cpu2 = "/cpus/cpu@002";
		cpu3 = "/cpus/cpu@003";
		cpu4 = "/cpus/cpu@100";
		cpu5 = "/cpus/cpu@101";
		cpu6 = "/cpus/cpu@102";
		cpu7 = "/cpus/cpu@103";
		STANDBY = "/cpus/idle-states/standby";
		MCDI_CPU = "/cpus/idle-states/mcdi-cpu";
		MCDI_CLUSTER = "/cpus/idle-states/mcdi-cluster";
		SODI = "/cpus/idle-states/sodi";
		SODI3 = "/cpus/idle-states/sodi3";
		DPIDLE = "/cpus/idle-states/dpidle";
		SUSPEND = "/cpus/idle-states/suspend";
		cpu_dbgapb = "/cpu_dbgapb@0d410000";
		msdc0 = "/msdc@11230000";
		msdc1 = "/msdc@11240000";
		reserved_memory = "/reserved-memory";
		gic = "/interrupt-controller@0c000000";
		sysirq = "/intpol-controller@0c530620";
		timer = "/timer";
		clk_null = "/clocks/clk_null";
		clk26m = "/clocks/clk26m";
		clk32k = "/clocks/clk32k";
		topckgen = "/topckgen@10000000";
		infracfg_ao = "/infracfg_ao@10001000";
		scpsys = "/scpsys@10001000";
		gpio_usage_mapping = "/gpio";
		gpio = "/gpio@10005000";
		syscfg_pctl_a = "/syscfg_pctl_a@10005000";
		syscfg_pctl_0 = "/syscfg_pctl_0@11f20000";
		syscfg_pctl_1 = "/syscfg_pctl_1@11e80000";
		syscfg_pctl_2 = "/syscfg_pctl_2@11e70000";
		syscfg_pctl_3 = "/syscfg_pctl_3@11e90000";
		syscfg_pctl_4 = "/syscfg_pctl_4@11d30000";
		syscfg_pctl_5 = "/syscfg_pctl_5@11d20000";
		syscfg_pctl_6 = "/syscfg_pctl_6@11c50000";
		syscfg_pctl_7 = "/syscfg_pctl_7@11f30000";
		pio = "/pinctrl@1000b000";
		msdc0_pins_default = "/pinctrl@1000b000/msdc0@default";
		msdc0_register_setting_default = "/pinctrl@1000b000/msdc0@register_default";
		msdc1_pins_default = "/pinctrl@1000b000/msdc1@default";
		msdc1_pins_sdr104 = "/pinctrl@1000b000/msdc1@sdr104";
		msdc1_pins_sdr50 = "/pinctrl@1000b000/msdc1@sdr50";
		msdc1_pins_ddr50 = "/pinctrl@1000b000/msdc1@ddr50";
		msdc1_register_setting_default = "/pinctrl@1000b000/msdc1@register_default";
		sdc1_cd = "/pinctrl@1000b000/sdc1_cd";
		sim1_cd = "/pinctrl@1000b000/sim1_cd";
		sim2_cd = "/pinctrl@1000b000/sim2_cd";
		i2c0 = "/i2c@11007000";
		i2c1 = "/i2c@11011000";
		i2c2 = "/i2c@11009000";
		i2c3 = "/i2c@1100f000";
		i2c4 = "/i2c@11008000";
		i2c5 = "/i2c@11017000";
		i2c6 = "/i2c@11005000";
		i2c7 = "/i2c@1101a000";
		i2c8 = "/i2c@1101b000";
		i2c9 = "/i2c@11014000";
		i2c10 = "/i2c@11015000";
		i2c11 = "/i2c@11016000";
		apmixed = "/apmixed@1000c000";
		main_pmic = "/pwrap@1000d000/pmic_irq";
		keypad = "/kp@10010000";
		mrdump_ext_rst = "/mrdump_ext_rst";
		scp = "/scp@10500000";
		wifi = "/wifi@180f0000";
		mdcldma = "/mdcldma@10014000";
		auxadc = "/auxadc@11001000";
		apdma = "/dma-controller@11000780";
		apuart0 = "/serial@11002000";
		apuart1 = "/serial@11003000";
		apuart2 = "/serial@11004000";
		spi0 = "/spi@1100a000";
		spi1 = "/spi@11010000";
		spi2 = "/spi@11012000";
		spi3 = "/spi@11013000";
		spi4 = "/spi@11018000";
		spi5 = "/spi@11019000";
		consys = "/consys@18070000";
		irtx_pwm = "/irtx_pwm";
		usb0 = "/usb3@11200000";
		otg_iddig = "/otg_iddig";
		usb3_tune = "/usb3_tune";
		xhci0 = "/usb3_xhci@11200000";
		audio = "/audio@11220000";
		audgpio = "/mt_soc_dl1_pcm@11220000";
		ufshci = "/ufshci@11270000";
		mfgcfg = "/mfgcfg@13000000";
		mmsys_config = "/mmsys_config@14000000";
		touch = "/touch";
		accdet = "/accdet";
		bat_gm30 = "/battery";
		mdp_rdma0 = "/mdp_rdma0@14001000";
		mdp_rdma1 = "/mdp_rdma1@14002000";
		mdp_rsz0 = "/mdp_rsz0@14003000";
		mdp_rsz1 = "/mdp_rsz1@14004000";
		mdp_wrot0 = "/mdp_wrot0@14005000";
		mdp_wdma = "/mdp_wdma@14006000";
		mdp_tdshp = "/mdp_tdshp@14007000";
		mtkfb = "/mtkfb@0";
		dsi_te = "/dsi_te";
		mhl = "/mhl@0";
		disp_color0 = "/disp_color0@1400e000";
		disp_aal0 = "/disp_aal0@14010000";
		disp_mutex = "/disp_mutex@14016000";
		smi_larb0 = "/smi_larb0@14017000";
		mdp_aal = "/mdp_aal@1401b000";
		mdp_ccorr = "/mdp_ccorr@1401c000";
		vdec_gcon = "/vdec_gcon@16000000";
		smi_larb1 = "/smi_larb1@16010000";
		venc_gcon = "/venc_gcon@17000000";
		smi_larb4 = "/smi_larb4@17010000";
		venc = "/venc@17020000";
		imgsys = "/imgsys@15020000";
		smi_larb2 = "/smi_larb2@1502f000";
		smi_larb5 = "/smi_larb5@15021000";
		camsys = "/camsys@1a000000";
		ipu_conn = "/ipu_conn@19000000";
		ipu_adl = "/ipu_adl@19010000";
		ipu0 = "/ipu0@19180000";
		ipu1 = "/ipu1@19280000";
		smi_larb3 = "/smi_larb3@1a002000";
		smi_larb6 = "/smi_larb6@1a001000";
		kd_camera_hw1 = "/kd_camera_hw1@1a040000";
		flashlight_core = "/flashlight_core";
		flashlights_mt6370 = "/flashlights_mt6370";
		flashlights_lm3644 = "/flashlights_lm3644";
		usbphy0 = "/usbphy";
		odm = "/odm";
		radio_md_cfg = "/radio_md_cfg";
		dynamic_options = "/dynamic_options";
		mt_charger = "/mt_charger";
		lk_charger = "/lk_charger";
		charger = "/charger";
		rt9465_slave_chr = "/rt9465_slave_chr";
		bat_metter = "/bat_metter";
		battery_id = "/battery_id";
		power_control = "/power_control";
		fuelsummary = "/fuelsummary";
		subpmic_pmu_eint = "/mt6370_pmu_eint";
		goodix_fp = "/fingerprint";
		fpsensor_fp_eint = "/fpsensor_fp_eint";
		fp_id = "/fp_id_detect";
		tcpc_pd = "/mt6370_pd_eint";
		rt5081_pmu_eint = "/rt5081_pmu_eint";
		rt5081_pd = "/rt5081_pd_eint";
		pmic_clock_buffer_ctrl = "/pmic_clock_buffer_ctrl";
		msdc1_ins = "/msdc1_ins";
		gyro = "/gyro";
		mse = "/mse";
		als = "/als";
		nfc = "/nfc";
		irq_nfc = "/irq_nfc";
		smart_pa = "/smart_pa";
		md1_sim1_hot_plug_eint = "/md1_sim1_hot_plug_eint";
		md1_sim2_hot_plug_eint = "/md1_sim2_hot_plug_eint";
		usb_c_pinctrl = "/usb_c_pinctrl";
		ssusb_ip_sleep = "/ssusb_ip_sleep";
		touchscreencfg = "/touchscreencfg";
		sar_power = "/sar_power_device";
		alsps_hub = "/alsps_hub_device";
		vivo_vib8846 = "/vivo_vib8846";
		board_info = "/vivo_board_info";
		mt_pmic_vdram1_buck_reg = "/mt_pmic_regulator/buck_regulators/buck_vdram1";
		mt_pmic_vcore_buck_reg = "/mt_pmic_regulator/buck_regulators/buck_vcore";
		mt_pmic_vpa_buck_reg = "/mt_pmic_regulator/buck_regulators/buck_vpa";
		mt_pmic_vproc11_buck_reg = "/mt_pmic_regulator/buck_regulators/buck_vproc11";
		mt_pmic_vproc12_buck_reg = "/mt_pmic_regulator/buck_regulators/buck_vproc12";
		mt_pmic_vgpu_buck_reg = "/mt_pmic_regulator/buck_regulators/buck_vgpu";
		mt_pmic_vs2_buck_reg = "/mt_pmic_regulator/buck_regulators/buck_vs2";
		mt_pmic_vmodem_buck_reg = "/mt_pmic_regulator/buck_regulators/buck_vmodem";
		mt_pmic_vs1_buck_reg = "/mt_pmic_regulator/buck_regulators/buck_vs1";
		mt_pmic_vdram2_ldo_reg = "/mt_pmic_regulator/ldo_regulators/ldo_vdram2";
		mt_pmic_vsim1_ldo_reg = "/mt_pmic_regulator/ldo_regulators/ldo_vsim1";
		mt_pmic_vibr_ldo_reg = "/mt_pmic_regulator/ldo_regulators/ldo_vibr";
		mt_pmic_vrf12_ldo_reg = "/mt_pmic_regulator/ldo_regulators/ldo_vrf12";
		mt_pmic_vio18_ldo_reg = "/mt_pmic_regulator/ldo_regulators/ldo_vio18";
		mt_pmic_vusb_ldo_reg = "/mt_pmic_regulator/ldo_regulators/ldo_vusb";
		mt_pmic_vcamio_ldo_reg = "/mt_pmic_regulator/ldo_regulators/ldo_vcamio";
		mt_pmic_vcamd_ldo_reg = "/mt_pmic_regulator/ldo_regulators/ldo_vcamd";
		mt_pmic_vcn18_ldo_reg = "/mt_pmic_regulator/ldo_regulators/ldo_vcn18";
		mt_pmic_vfe28_ldo_reg = "/mt_pmic_regulator/ldo_regulators/ldo_vfe28";
		mt_pmic_vsram_proc11_ldo_reg = "/mt_pmic_regulator/ldo_regulators/ldo_vsram_proc11";
		mt_pmic_vcn28_ldo_reg = "/mt_pmic_regulator/ldo_regulators/ldo_vcn28";
		mt_pmic_vsram_others_ldo_reg = "/mt_pmic_regulator/ldo_regulators/ldo_vsram_others";
		mt_pmic_vsram_gpu_ldo_reg = "/mt_pmic_regulator/ldo_regulators/ldo_vsram_gpu";
		mt_pmic_vxo22_ldo_reg = "/mt_pmic_regulator/ldo_regulators/ldo_vxo22";
		mt_pmic_vefuse_ldo_reg = "/mt_pmic_regulator/ldo_regulators/ldo_vefuse";
		mt_pmic_vaux18_ldo_reg = "/mt_pmic_regulator/ldo_regulators/ldo_vaux18";
		mt_pmic_vmch_ldo_reg = "/mt_pmic_regulator/ldo_regulators/ldo_vmch";
		mt_pmic_vbif28_ldo_reg = "/mt_pmic_regulator/ldo_regulators/ldo_vbif28";
		mt_pmic_vsram_proc12_ldo_reg = "/mt_pmic_regulator/ldo_regulators/ldo_vsram_proc12";
		mt_pmic_vcama1_ldo_reg = "/mt_pmic_regulator/ldo_regulators/ldo_vcama1";
		mt_pmic_vemc_ldo_reg = "/mt_pmic_regulator/ldo_regulators/ldo_vemc";
		mt_pmic_vio28_ldo_reg = "/mt_pmic_regulator/ldo_regulators/ldo_vio28";
		mt_pmic_va12_ldo_reg = "/mt_pmic_regulator/ldo_regulators/ldo_va12";
		mt_pmic_vrf18_ldo_reg = "/mt_pmic_regulator/ldo_regulators/ldo_vrf18";
		mt_pmic_vcn33_bt_ldo_reg = "/mt_pmic_regulator/ldo_regulators/ldo_vcn33_bt";
		mt_pmic_vcn33_wifi_ldo_reg = "/mt_pmic_regulator/ldo_regulators/ldo_vcn33_wifi";
		mt_pmic_vcama2_ldo_reg = "/mt_pmic_regulator/ldo_regulators/ldo_vcama2";
		mt_pmic_vmc_ldo_reg = "/mt_pmic_regulator/ldo_regulators/ldo_vmc";
		mt_pmic_vldo28_ldo_reg = "/mt_pmic_regulator/ldo_regulators/ldo_vldo28";
		mt_pmic_vaud28_ldo_reg = "/mt_pmic_regulator/ldo_regulators/ldo_vaud28";
		mt_pmic_vsim2_ldo_reg = "/mt_pmic_regulator/ldo_regulators/ldo_vsim2";
		mt_pmic_va09_ldo_reg = "/mt_pmic_regulator/ldo_regulators/ldo_va09";
		mt6370_pmu = "/mt6370_pmu_dts";
		mt6370_typec = "/type_c_port0";
	};
};
